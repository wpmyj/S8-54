#include "font.h"
const Font fontUGO = {
	8, {
/*0*/		{ 0, { 0,	0,	0,	0,	0,	0,	0,	0	} },	
/*1*/		{ 0, { 0,	0,	0,	0,	0,	0,	0,	0	} },	
/*2*/		{ 0, { 0,	0,	0,	0,	0,	0,	0,	0	} },	
/*3*/		{ 0, { 0,	0,	0,	0,	0,	0,	0,	0	} },	
/*4*/		{ 0, { 0,	0,	0,	0,	0,	0,	0,	0	} },	
/*5*/		{ 0, { 0,	0,	0,	0,	0,	0,	0,	0	} },	
/*6*/		{ 0, { 0,	0,	0,	0,	0,	0,	0,	0	} },	
/*7*/		{ 0, { 0,	0,	0,	0,	0,	0,	0,	0	} },	
/*8*/		{ 0, { 0,	0,	0,	0,	0,	0,	0,	0	} },	
/*9*/		{ 0, { 0,	0,	0,	0,	0,	0,	0,	0	} },	
/*10*/		{ 0, { 0,	0,	0,	0,	0,	0,	0,	0	} },	
/*11*/		{ 0, { 0,	0,	0,	0,	0,	0,	0,	0	} },	
/*12*/		{ 0, { 0,	0,	0,	0,	0,	0,	0,	0	} },	
/*13*/		{ 0, { 0,	0,	0,	0,	0,	0,	0,	0	} },	
/*14*/		{ 0, { 0,	0,	0,	0,	0,	0,	0,	0	} },	
/*15*/		{ 0, { 0,	0,	0,	0,	0,	0,	0,	0	} },	
/*16*/		{ 0, { 0,	0,	0,	0,	0,	0,	0,	0	} },	
/*17*/		{ 1, { 0,	0,	0,	0,	0,	0,	0,	0	} },	
/*18*/		{ 2, { 0,	0,	0,	0,	0,	0,	0,	0	} },	
/*19*/		{ 3, { 0,	0,	0,	0,	0,	0,	0,	0	} },	
/*20*/		{ 4, { 0,	0,	0,	0,	0,	0,	0,	0	} },	
/*21*/		{ 5, { 0,	0,	0,	0,	0,	0,	0,	0	} },	
/*22*/		{ 6, { 0,	0,	0,	0,	0,	0,	0,	0	} },	
/*23*/		{ 7, { 0,	0,	0,	0,	0,	0,	0,	0	} },	
/*24*/		{ 8, { 0,	0,	0,	0,	0,	0,	0,	0	} },	
/*25*/		{ 9, { 0,	0,	0,	0,	0,	0,	0,	0	} },	
/*26*/		{ 10, { 0,	0,	0,	0,	0,	0,	0,	0	} },	
/*27*/		{ 11, { 0,	0,	0,	0,	0,	0,	0,	0	} },	
/*28*/		{ 12, { 0,	0,	0,	0,	0,	0,	0,	0	} },	
/*29*/		{ 13, { 0,	0,	0,	0,	0,	0,	0,	0	} },	
/*30*/		{ 14, { 0,	0,	0,	0,	0,	0,	0,	0	} },	
/*31*/		{ 15, { 0,	0,	0,	0,	0,	0,	0,	0	} },	
/*32*/		{ 8, { 34,	112,	248,	32,	32,	32,	32,	35	} },	
/*33*/		{ 8, { 170,	6,	11,	9,	8,	8,	8,	200	} },	
/*34*/		{ 7, { 170,	0,	248,	140,	4,	4,	4,	6	} },	
/*35*/		{ 8, { 170,	3,	5,	4,	4,	4,	4,	4	} },	
/*36*/		{ 8, { 170,	0,	252,	198,	2,	2,	2,	3	} },	
/*37*/		{ 8, { 0,	0,	0,	0,	0,	0,	0,	3	} },	
/*38*/		{ 8, { 0,	6,	11,	9,	8,	8,	8,	200	} },	
/*39*/		{ 7, { 0,	0,	248,	140,	4,	4,	4,	6	} },	
/*40*/		{ 8, { 0,	0,	1,	1,	1,	1,	1,	35	} },	
/*41*/		{ 7, { 0,	192,	60,	6,	2,	2,	2,	2	} },	
/*42*/		{ 7, { 34,	112,	248,	32,	32,	32,	32,	32	} },	
/*43*/		{ 8, { 170,	12,	23,	16,	16,	16,	16,	16	} },	
/*44*/		{ 7, { 170,	0,	192,	32,	32,	32,	32,	48	} },	
/*45*/		{ 8, { 170,	28,	55,	32,	32,	32,	32,	32	} },	
/*46*/		{ 7, { 170,	0,	128,	96,	32,	32,	32,	32	} },	
/*47*/		{ 0, { 0,	0,	0,	0,	0,	0,	0,	0	} },	
/*48*/		{ 5, { 32,	32,	32,	32,	32,	32,	32,	248	} },	
/*49*/		{ 5, { 104,	48,	0,	0,	0,	0,	0,	0	} },	
/*50*/		{ 8, { 2,	1,	0,	0,	0,	0,	0,	0	} },	
/*51*/		{ 6, { 100,	244,	24,	0,	0,	0,	0,	0	} },	
/*52*/		{ 8, { 1,	0,	0,	0,	0,	0,	0,	0	} },	
/*53*/		{ 7, { 0,	0,	34,	112,	248,	32,	32,	248	} },	
/*54*/		{ 7, { 104,	48,	170,	0,	0,	0,	0,	0	} },	
/*55*/		{ 8, { 3,	0,	170,	0,	0,	0,	0,	0	} },	
/*56*/		{ 7, { 242,	28,	170,	0,	0,	0,	0,	0	} },	
/*57*/		{ 8, { 2,	1,	170,	0,	0,	0,	0,	0	} },	
/*58*/		{ 8, { 32,	251,	112,	34,	0,	0,	0,	0	} },	
/*59*/		{ 7, { 16,	176,	192,	170,	0,	0,	0,	0	} },	
/*60*/		{ 8, { 16,	28,	7,	170,	0,	0,	0,	0	} },	
/*61*/		{ 7, { 32,	96,	192,	170,	0,	0,	0,	0	} },	
/*62*/		{ 8, { 32,	39,	28,	170,	0,	0,	0,	0	} },	
/*63*/		{ 0, { 0,	0,	0,	0,	0,	0,	0,	0	} },	
/*64*/		{ 8, { 0,	0,	34,	112,	248,	32,	32,	35	} },	
/*65*/		{ 8, { 2,	6,	171,	9,	8,	8,	8,	200	} },	
/*66*/		{ 7, { 0,	0,	250,	140,	4,	4,	4,	6	} },	
/*67*/		{ 8, { 1,	7,	174,	4,	4,	4,	4,	4	} },	
/*68*/		{ 8, { 0,	0,	252,	70,	2,	2,	2,	3	} },	
/*69*/		{ 8, { 0,	0,	0,	0,	0,	0,	0,	35	} },	
/*70*/		{ 8, { 2,	6,	11,	9,	8,	8,	8,	234	} },	
/*71*/		{ 8, { 0,	0,	240,	152,	8,	8,	8,	175	} },	
/*72*/		{ 8, { 4,	6,	11,	9,	8,	8,	24,	250	} },	
/*73*/		{ 7, { 0,	8,	248,	168,	8,	8,	8,	174	} },	
/*74*/		{ 7, { 0,	0,	34,	112,	248,	32,	32,	32	} },	
/*75*/		{ 8, { 2,	6,	173,	8,	8,	8,	8,	8	} },	
/*76*/		{ 7, { 0,	0,	250,	4,	4,	4,	4,	4	} },	
/*77*/		{ 8, { 4,	7,	171,	8,	8,	8,	8,	8	} },	
/*78*/		{ 7, { 0,	0,	250,	4,	4,	4,	4,	4	} },	
/*79*/		{ 0, { 0,	0,	0,	0,	0,	0,	0,	0	} },	
/*80*/		{ 5, { 32,	32,	32,	32,	32,	32,	32,	248	} },	
/*81*/		{ 5, { 104,	48,	0,	0,	0,	0,	0,	0	} },	
/*82*/		{ 8, { 2,	1,	0,	0,	0,	0,	0,	0	} },	
/*83*/		{ 6, { 100,	244,	24,	0,	0,	0,	0,	0	} },	
/*84*/		{ 8, { 1,	0,	0,	0,	0,	0,	0,	0	} },	
/*85*/		{ 5, { 112,	248,	32,	32,	32,	32,	32,	248	} },	
/*86*/		{ 5, { 104,	48,	0,	0,	0,	0,	0,	0	} },	
/*87*/		{ 8, { 3,	0,	0,	0,	0,	0,	0,	0	} },	
/*88*/		{ 4, { 144,	0,	0,	0,	0,	0,	0,	0	} },	
/*89*/		{ 8, { 3,	0,	0,	0,	0,	0,	0,	0	} },	
/*90*/		{ 8, { 248,	112,	35,	0,	0,	0,	0,	0	} },	
/*91*/		{ 7, { 8,	8,	250,	48,	0,	0,	0,	0	} },	
/*92*/		{ 8, { 4,	4,	171,	0,	0,	0,	0,	0	} },	
/*93*/		{ 7, { 8,	8,	250,	112,	16,	0,	0,	0	} },	
/*94*/		{ 8, { 4,	4,	171,	0,	0,	0,	0,	0	} },	
/*95*/		{ 0, { 0,	0,	0,	0,	0,	0,	0,	0	} },	
/*96*/		{ 8, { 0,	0,	1,	1,	2,	7,	34,	112	} },	
/*97*/		{ 8, { 96,	144,	8,	8,	4,	85,	4,	2	} },	
/*98*/		{ 8, { 1,	2,	4,	4,	8,	93,	8,	16	} },	
/*99*/		{ 8, { 128,	64,	32,	32,	16,	85,	16,	8	} },	
/*100*/		{ 8, { 6,	9,	16,	16,	32,	117,	32,	64	} },	
/*101*/		{ 8, { 0,	0,	37,	113,	250,	34,	34,	32	} },	
/*102*/		{ 8, { 96,	144,	93,	8,	4,	4,	4,	2	} },	
/*103*/		{ 8, { 1,	2,	85,	4,	8,	8,	8,	16	} },	
/*104*/		{ 8, { 128,	64,	117,	32,	16,	16,	16,	8	} },	
/*105*/		{ 8, { 6,	9,	85,	16,	32,	32,	32,	64	} },	
/*106*/		{ 8, { 37,	112,	248,	32,	248,	112,	37,	0	} },	
/*107*/		{ 8, { 85,	0,	0,	0,	0,	0,	85,	0	} },	
/*108*/		{ 8, { 85,	160,	160,	164,	170,	170,	170,	170	} },	
/*109*/		{ 8, { 85,	0,	0,	0,	0,	0,	255,	128	} },	
/*110*/		{ 8, { 85,	0,	0,	0,	0,	0,	255,	0	} },	
/*111*/		{ 0, { 0,	0,	0,	0,	0,	0,	0,	0	} },	
/*112*/		{ 5, { 248,	32,	32,	32,	32,	32,	32,	248	} },	
/*113*/		{ 8, { 2,	1,	0,	0,	0,	0,	0,	0	} },	
/*114*/		{ 4, { 16,	32,	192,	0,	0,	0,	0,	0	} },	
/*115*/		{ 8, { 8,	4,	3,	0,	0,	0,	0,	0	} },	
/*116*/		{ 2, { 64,	128,	0,	0,	0,	0,	0,	0	} },	
/*117*/		{ 5, { 32,	32,	32,	32,	32,	32,	32,	248	} },	
/*118*/		{ 8, { 2,	1,	0,	0,	0,	0,	0,	0	} },	
/*119*/		{ 4, { 16,	32,	192,	0,	0,	0,	0,	0	} },	
/*120*/		{ 8, { 8,	4,	3,	0,	0,	0,	0,	0	} },	
/*121*/		{ 2, { 64,	128,	0,	0,	0,	0,	0,	0	} },	
/*122*/		{ 8, { 0,	0,	0,	0,	7,	0,	0,	0	} },	
/*123*/		{ 8, { 0,	0,	0,	0,	254,	1,	0,	0	} },	
/*124*/		{ 8, { 169,	168,	144,	128,	128,	0,	0,	0	} },	
/*125*/		{ 0, { 0,	0,	0,	0,	0,	0,	0,	0	} },	
/*126*/		{ 0, { 0,	0,	0,	0,	0,	0,	0,	0	} },	
/*127*/		{ 0, { 0,	0,	0,	0,	0,	0,	0,	0	} },	
/*128*/		{ 8, { 0,	0,	255,	0,	0,	0,	0,	0	} },	
/*129*/		{ 8, { 0,	0,	255,	1,	1,	1,	1,	1	} },	
/*130*/		{ 7, { 0,	0,	0,	0,	0,	0,	32,	82	} },	
/*131*/		{ 0, { 0,	0,	0,	0,	0,	0,	0,	0	} },	
/*132*/		{ 0, { 0,	0,	0,	0,	0,	0,	0,	0	} },	
/*133*/		{ 8, { 1,	1,	1,	1,	7,	1,	1,	1	} },	
/*134*/		{ 8, { 255,	1,	1,	1,	193,	1,	1,	1	} },	
/*135*/		{ 8, { 1,	1,	1,	1,	7,	1,	1,	1	} },	
/*136*/		{ 8, { 255,	1,	1,	1,	193,	1,	1,	1	} },	
/*137*/		{ 0, { 0,	0,	0,	0,	0,	0,	0,	0	} },	
/*138*/		{ 8, { 127,	1,	1,	1,	7,	1,	97,	33	} },	
/*139*/		{ 8, { 1,	1,	1,	1,	193,	1,	1,	1	} },	
/*140*/		{ 8, { 255,	1,	1,	1,	7,	1,	1,	1	} },	
/*141*/		{ 8, { 1,	1,	1,	1,	193,	1,	1,	1	} },	
/*142*/		{ 8, { 255,	0,	0,	0,	0,	0,	0,	0	} },	
/*143*/		{ 0, { 0,	0,	0,	0,	0,	0,	0,	0	} },	
/*144*/		{ 8, { 21,	56,	124,	0,	124,	56,	18,	0	} },	
/*145*/		{ 8, { 85,	1,	1,	1,	1,	1,	170,	0	} },	
/*146*/		{ 8, { 85,	84,	84,	84,	72,	64,	128,	0	} },	
/*147*/		{ 8, { 255,	0,	0,	0,	0,	0,	0,	0	} },	
/*148*/		{ 8, { 255,	0,	0,	0,	0,	0,	0,	0	} },	
/*149*/		{ 8, { 127,	0,	0,	0,	1,	0,	0,	0	} },	
/*150*/		{ 8, { 1,	0,	64,	192,	255,	192,	64,	0	} },	
/*151*/		{ 8, { 255,	0,	4,	6,	255,	6,	4,	0	} },	
/*152*/		{ 8, { 1,	0,	0,	0,	0,	0,	0,	0	} },	
/*153*/		{ 8, { 255,	0,	0,	0,	0,	0,	0,	0	} },	
/*154*/		{ 8, { 33,	32,	114,	4,	9,	16,	32,	0	} },	
/*155*/		{ 8, { 255,	0,	64,	192,	255,	192,	64,	0	} },	
/*156*/		{ 8, { 1,	0,	4,	6,	255,	6,	4,	0	} },	
/*157*/		{ 8, { 255,	0,	0,	0,	0,	0,	0,	0	} },	
/*158*/		{ 0, { 0,	0,	0,	0,	0,	0,	0,	0	} },	
/*159*/		{ 0, { 0,	0,	0,	0,	0,	0,	0,	0	} },	
/*160*/		{ 0, { 0,	0,	0,	0,	0,	0,	0,	0	} },	
/*161*/		{ 0, { 0,	0,	0,	0,	0,	0,	0,	0	} },	
/*162*/		{ 8, { 0,	0,	1,	0,	1,	2,	4,	8	} },	
/*163*/		{ 8, { 31,	32,	240,	128,	0,	0,	0,	0	} },	
/*164*/		{ 8, { 255,	0,	0,	0,	0,	0,	0,	0	} },	
/*165*/		{ 8, { 255,	0,	0,	0,	0,	0,	0,	0	} },	
/*166*/		{ 8, { 252,	2,	7,	0,	0,	0,	0,	0	} },	
/*167*/		{ 5, { 0,	0,	192,	128,	64,	32,	16,	8	} },	
/*168*/		{ 0, { 0,	0,	0,	0,	0,	0,	0,	0	} },	
/*169*/		{ 0, { 0,	0,	0,	0,	0,	0,	0,	0	} },	
/*170*/		{ 8, { 0,	0,	0,	0,	3,	0,	0,	0	} },	
/*171*/		{ 8, { 255,	128,	128,	128,	224,	128,	128,	128	} },	
/*172*/		{ 8, { 254,	2,	2,	2,	15,	2,	2,	2	} },	
/*173*/		{ 1, { 0,	0,	0,	0,	128,	0,	0,	0	} },	
/*174*/		{ 0, { 0,	0,	0,	0,	0,	0,	0,	0	} },	
/*175*/		{ 0, { 0,	0,	0,	0,	0,	0,	0,	0	} },	
/*176*/		{ 8, { 0,	0,	0,	0,	255,	0,	0,	0	} },	
/*177*/		{ 8, { 0,	0,	1,	0,	255,	0,	0,	0	} },	
/*178*/		{ 8, { 17,	35,	247,	131,	1,	0,	0,	0	} },	
/*179*/		{ 4, { 64,	96,	240,	96,	64,	0,	0,	0	} },	
/*180*/		{ 0, { 0,	0,	0,	0,	0,	0,	0,	0	} },	
/*181*/		{ 0, { 0,	0,	0,	0,	0,	0,	0,	0	} },	
/*182*/		{ 8, { 1,	3,	7,	3,	1,	0,	0,	0	} },	
/*183*/		{ 8, { 68,	98,	247,	96,	64,	0,	0,	0	} },	
/*184*/		{ 8, { 0,	0,	192,	128,	127,	0,	0,	0	} },	
/*185*/		{ 8, { 0,	0,	0,	0,	255,	0,	0,	0	} },	
/*186*/		{ 8, { 255,	0,	0,	0,	0,	0,	0,	0	} },	
/*187*/		{ 8, { 128,	0,	32,	96,	255,	96,	32,	0	} },	
/*188*/		{ 8, { 3,	0,	8,	12,	254,	12,	8,	0	} },	
/*189*/		{ 8, { 255,	0,	0,	0,	0,	0,	0,	0	} },	
/*190*/		{ 8, { 255,	0,	0,	0,	0,	0,	0,	0	} },	
/*191*/		{ 0, { 0,	0,	0,	0,	0,	0,	0,	0	} },	
/*192*/		{ 8, { 255,	0,	0,	0,	3,	0,	0,	0	} },	
/*193*/		{ 3, { 128,	128,	128,	128,	224,	128,	128,	128	} },	
/*194*/		{ 8, { 3,	2,	2,	2,	15,	2,	2,	2	} },	
/*195*/		{ 8, { 255,	0,	0,	0,	128,	0,	0,	0	} },	
/*196*/		{ 8, { 255,	0,	0,	0,	0,	0,	0,	0	} },	
/*197*/		{ 8, { 0,	0,	0,	0,	3,	0,	0,	0	} },	
/*198*/		{ 8, { 255,	128,	128,	128,	224,	128,	128,	128	} },	
/*199*/		{ 8, { 254,	2,	2,	2,	15,	2,	2,	2	} },	
/*200*/		{ 8, { 1,	1,	1,	1,	129,	1,	1,	1	} },	
/*201*/		{ 8, { 255,	0,	0,	0,	0,	0,	0,	0	} },	
/*202*/		{ 8, { 255,	0,	0,	0,	3,	0,	0,	0	} },	
/*203*/		{ 3, { 128,	128,	128,	128,	224,	128,	128,	128	} },	
/*204*/		{ 8, { 3,	2,	2,	2,	15,	2,	2,	2	} },	
/*205*/		{ 8, { 255,	1,	1,	1,	129,	1,	1,	1	} },	
/*206*/		{ 0, { 0,	0,	0,	0,	0,	0,	0,	0	} },	
/*207*/		{ 0, { 0,	0,	0,	0,	0,	0,	0,	0	} },	
/*208*/		{ 0, { 0,	0,	0,	0,	0,	0,	0,	0	} },	
/*209*/		{ 8, { 255,	0,	32,	96,	255,	96,	32,	0	} },	
/*210*/		{ 7, { 254,	0,	8,	12,	254,	12,	8,	0	} },	
/*211*/		{ 0, { 0,	0,	0,	0,	0,	0,	0,	0	} },	
/*212*/		{ 0, { 0,	0,	0,	0,	0,	0,	0,	0	} },	
/*213*/		{ 8, { 255,	0,	0,	0,	0,	0,	0,	0	} },	
/*214*/		{ 8, { 128,	0,	32,	96,	255,	96,	32,	0	} },	
/*215*/		{ 8, { 3,	0,	8,	12,	254,	12,	8,	0	} },	
/*216*/		{ 8, { 255,	0,	0,	0,	0,	0,	0,	0	} },	
/*217*/		{ 0, { 0,	0,	0,	0,	0,	0,	0,	0	} },	
/*218*/		{ 0, { 0,	0,	0,	0,	0,	0,	0,	0	} },	
/*219*/		{ 8, { 255,	0,	32,	96,	255,	96,	32,	0	} },	
/*220*/		{ 7, { 254,	0,	8,	12,	254,	12,	8,	0	} },	
/*221*/		{ 8, { 1,	0,	0,	0,	0,	0,	0,	0	} },	
/*222*/		{ 8, { 255,	0,	0,	0,	0,	0,	0,	0	} },	
/*223*/		{ 0, { 0,	0,	0,	0,	0,	0,	0,	0	} },	
/*224*/		{ 8, { 0,	0,	0,	0,	3,	1,	1,	1	} },	
/*225*/		{ 8, { 63,	32,	32,	32,	34,	38,	47,	38	} },	
/*226*/		{ 8, { 255,	0,	0,	0,	0,	0,	255,	0	} },	
/*227*/		{ 8, { 255,	0,	7,	4,	69,	100,	245,	101	} },	
/*228*/		{ 8, { 255,	0,	255,	0,	192,	64,	192,	0	} },	
/*229*/		{ 8, { 255,	0,	255,	0,	3,	1,	1,	1	} },	
/*230*/		{ 8, { 255,	0,	224,	32,	34,	38,	47,	38	} },	
/*231*/		{ 8, { 255,	0,	0,	0,	0,	0,	255,	0	} },	
/*232*/		{ 8, { 252,	4,	4,	4,	69,	100,	245,	101	} },	
/*233*/		{ 2, { 0,	0,	0,	0,	192,	64,	192,	0	} },	
/*234*/		{ 0, { 0,	0,	0,	0,	0,	0,	0,	0	} },	
/*235*/		{ 0, { 0,	0,	0,	0,	0,	0,	0,	0	} },	
/*236*/		{ 0, { 0,	0,	0,	0,	0,	0,	0,	0	} },	
/*237*/		{ 0, { 0,	0,	0,	0,	0,	0,	0,	0	} },	
/*238*/		{ 0, { 0,	0,	0,	0,	0,	0,	0,	0	} },	
/*239*/		{ 0, { 0,	0,	0,	0,	0,	0,	0,	0	} },	
/*240*/		{ 8, { 3,	0,	255,	0,	255,	0,	0,	0	} },	
/*241*/		{ 8, { 162,	32,	224,	0,	255,	0,	0,	0	} },	
/*242*/		{ 8, { 0,	0,	0,	0,	255,	0,	0,	0	} },	
/*243*/		{ 8, { 69,	4,	4,	4,	252,	0,	0,	0	} },	
/*244*/		{ 2, { 192,	0,	0,	0,	0,	0,	0,	0	} },	
/*245*/		{ 8, { 3,	0,	0,	0,	0,	0,	0,	0	} },	
/*246*/		{ 8, { 162,	32,	32,	32,	63,	0,	0,	0	} },	
/*247*/		{ 8, { 0,	0,	0,	0,	255,	0,	0,	0	} },	
/*248*/		{ 8, { 69,	4,	7,	0,	255,	0,	0,	0	} },	
/*249*/		{ 8, { 192,	0,	255,	0,	255,	0,	0,	0	} },	
/*250*/		{ 0, { 0,	0,	0,	0,	0,	0,	0,	0	} },	
/*251*/		{ 0, { 0,	0,	0,	0,	0,	0,	0,	0	} },	
/*252*/		{ 0, { 0,	0,	0,	0,	0,	0,	0,	0	} },	
/*253*/		{ 0, { 0,	0,	0,	0,	0,	0,	0,	0	} },	
/*254*/		{ 0, { 0,	0,	0,	0,	0,	0,	0,	0	} },	
/*255*/		{ 0, { 0,	0,	0,	0,	0,	0,	0,	0	} }	
} };
