/* Main font height 8 */

const BYTE font8display[3080] = {

/* Orient = 0x00, FontID = 0x00 */ 0x00, 0x00,
/* First character ID */           0x00, 0x00,
/* Last  character ID */           0xff, 0xff,
/* Height */                       0x08, 0x00,

/* Table of characters */

/*  0  */	        0, 8, 4, 0,
/*  1  */	        0, 16, 4, 0,
/*  2  */	        0, 24, 4, 0,
/*  3  */	        0, 32, 4, 0,
/*  4  */	        0, 40, 4, 0,
/*  5  */	        0, 48, 4, 0,
/*  6  */	        0, 56, 4, 0,
/*  7  */	        0, 64, 4, 0,
/*  8  */	        0, 72, 4, 0,
/*  9  */	        0, 80, 4, 0,
/*  10  */	        0, 88, 4, 0,
/*  11  */	        0, 96, 4, 0,
/*  12  */	        0, 104, 4, 0,
/*  13  */	        5, 112, 4, 0,
/*  14  */	        8, 120, 4, 0,
/*  15  */	        1, 128, 4, 0,
/*  16  */	        0, 136, 4, 0,
/*  17  */	        1, 144, 4, 0,
/*  18  */	        2, 152, 4, 0,
/*  19  */	        3, 160, 4, 0,
/*  20  */	        4, 168, 4, 0,
/*  21  */	        5, 176, 4, 0,
/*  22  */	        6, 184, 4, 0,
/*  23  */	        7, 192, 4, 0,
/*  24  */	        8, 200, 4, 0,
/*  25  */	        9, 208, 4, 0,
/*  26  */	        10, 216, 4, 0,
/*  27  */	        11, 224, 4, 0,
/*  28  */	        12, 232, 4, 0,
/*  29  */	        13, 240, 4, 0,
/*  30  */	        14, 248, 4, 0,
/*  31  */	        15, 0, 5, 0,
/*  32  */	        2, 8, 5, 0,
/*  33  */	        3, 16, 5, 0,
/*  34  */	        3, 24, 5, 0,
/*  35  */	        5, 32, 5, 0,
/*  36  */	        5, 40, 5, 0,
/*  37  */	        6, 48, 5, 0,
/*  38  */	        5, 56, 5, 0,
/*  39  */	        3, 64, 5, 0,
/*  40  */	        2, 72, 5, 0,
/*  41  */	        2, 80, 5, 0,
/*  42  */	        3, 88, 5, 0,
/*  43  */	        3, 96, 5, 0,
/*  44  */	        4, 104, 5, 0,
/*  45  */	        3, 112, 5, 0,
/*  46  */	        1, 120, 5, 0,
/*  47  */	        3, 128, 5, 0,
/*  48  */	        4, 136, 5, 0,
/*  49  */	        4, 144, 5, 0,
/*  50  */	        4, 152, 5, 0,
/*  51  */	        4, 160, 5, 0,
/*  52  */	        4, 168, 5, 0,
/*  53  */	        4, 176, 5, 0,
/*  54  */	        4, 184, 5, 0,
/*  55  */	        4, 192, 5, 0,
/*  56  */	        4, 200, 5, 0,
/*  57  */	        4, 208, 5, 0,
/*  58  */	        1, 216, 5, 0,
/*  59  */	        3, 224, 5, 0,
/*  60  */	        6, 232, 5, 0,
/*  61  */	        3, 240, 5, 0,
/*  62  */	        6, 248, 5, 0,
/*  63  */	        5, 0, 6, 0,
/*  64  */	        4, 8, 6, 0,
/*  65  */	        4, 16, 6, 0,
/*  66  */	        4, 24, 6, 0,
/*  67  */	        4, 32, 6, 0,
/*  68  */	        4, 40, 6, 0,
/*  69  */	        4, 48, 6, 0,
/*  70  */	        4, 56, 6, 0,
/*  71  */	        5, 64, 6, 0,
/*  72  */	        5, 72, 6, 0,
/*  73  */	        5, 80, 6, 0,
/*  74  */	        4, 88, 6, 0,
/*  75  */	        5, 96, 6, 0,
/*  76  */	        4, 104, 6, 0,
/*  77  */	        5, 112, 6, 0,
/*  78  */	        5, 120, 6, 0,
/*  79  */	        5, 128, 6, 0,
/*  80  */	        5, 136, 6, 0,
/*  81  */	        5, 144, 6, 0,
/*  82  */	        5, 152, 6, 0,
/*  83  */	        4, 160, 6, 0,
/*  84  */	        5, 168, 6, 0,
/*  85  */	        5, 176, 6, 0,
/*  86  */	        5, 184, 6, 0,
/*  87  */	        5, 192, 6, 0,
/*  88  */	        5, 200, 6, 0,
/*  89  */	        5, 208, 6, 0,
/*  90  */	        5, 216, 6, 0,
/*  91  */	        4, 224, 6, 0,
/*  92  */	        5, 232, 6, 0,
/*  93  */	        4, 240, 6, 0,
/*  94  */	        5, 248, 6, 0,
/*  95  */	        6, 0, 7, 0,
/*  96  */	        3, 8, 7, 0,
/*  97  */	        4, 16, 7, 0,
/*  98  */	        4, 24, 7, 0,
/*  99  */	        4, 32, 7, 0,
/*  100  */	        4, 40, 7, 0,
/*  101  */	        4, 48, 7, 0,
/*  102  */	        3, 56, 7, 0,
/*  103  */	        4, 64, 7, 0,
/*  104  */	        4, 72, 7, 0,
/*  105  */	        1, 80, 7, 0,
/*  106  */	        4, 88, 7, 0,
/*  107  */	        4, 96, 7, 0,
/*  108  */	        2, 104, 7, 0,
/*  109  */	        5, 112, 7, 0,
/*  110  */	        4, 120, 7, 0,
/*  111  */	        4, 128, 7, 0,
/*  112  */	        4, 136, 7, 0,
/*  113  */	        5, 144, 7, 0,
/*  114  */	        3, 152, 7, 0,
/*  115  */	        4, 160, 7, 0,
/*  116  */	        3, 168, 7, 0,
/*  117  */	        4, 176, 7, 0,
/*  118  */	        5, 184, 7, 0,
/*  119  */	        5, 192, 7, 0,
/*  120  */	        5, 200, 7, 0,
/*  121  */	        4, 208, 7, 0,
/*  122  */	        5, 216, 7, 0,
/*  123  */	        7, 224, 7, 0,
/*  124  */	        7, 232, 7, 0,
/*  125  */	        7, 240, 7, 0,
/*  126  */	        7, 248, 7, 0,
/*  127  */	        2, 0, 8, 0,
/*  128  */	        3, 8, 8, 0,
/*  129  */	        3, 16, 8, 0,
/*  130  */	        8, 24, 8, 0,
/*  131  */	        8, 32, 8, 0,
/*  132  */	        6, 40, 8, 0,
/*  133  */	        7, 48, 8, 0,
/*  134  */	        8, 56, 8, 0,
/*  135  */	        7, 64, 8, 0,
/*  136  */	        7, 72, 8, 0,
/*  137  */	        0, 80, 8, 0,
/*  138  */	        6, 88, 8, 0,
/*  139  */	        7, 96, 8, 0,
/*  140  */	        8, 104, 8, 0,
/*  141  */	        1, 112, 8, 0,
/*  142  */	        5, 120, 8, 0,
/*  143  */	        6, 128, 8, 0,
/*  144  */	        7, 136, 8, 0,
/*  145  */	        7, 144, 8, 0,
/*  146  */	        7, 152, 8, 0,
/*  147  */	        8, 160, 8, 0,
/*  148  */	        8, 168, 8, 0,
/*  149  */	        5, 176, 8, 0,
/*  150  */	        5, 184, 8, 0,
/*  151  */	        8, 192, 8, 0,
/*  152  */	        0, 200, 8, 0,
/*  153  */	        6, 208, 8, 0,
/*  154  */	        5, 216, 8, 0,
/*  155  */	        5, 224, 8, 0,
/*  156  */	        7, 232, 8, 0,
/*  157  */	        0, 240, 8, 0,
/*  158  */	        6, 248, 8, 0,
/*  159  */	        7, 0, 9, 0,
/*  160  */	        7, 8, 9, 0,
/*  161  */	        8, 16, 9, 0,
/*  162  */	        8, 24, 9, 0,
/*  163  */	        5, 32, 9, 0,
/*  164  */	        5, 40, 9, 0,
/*  165  */	        1, 48, 9, 0,
/*  166  */	        7, 56, 9, 0,
/*  167  */	        7, 64, 9, 0,
/*  168  */	        4, 72, 9, 0,
/*  169  */	        0, 80, 9, 0,
/*  170  */	        8, 88, 9, 0,
/*  171  */	        1, 96, 9, 0,
/*  172  */	        8, 104, 9, 0,
/*  173  */	        1, 112, 9, 0,
/*  174  */	        8, 120, 9, 0,
/*  175  */	        8, 128, 9, 0,
/*  176  */	        7, 136, 9, 0,
/*  177  */	        8, 144, 9, 0,
/*  178  */	        8, 152, 9, 0,
/*  179  */	        8, 160, 9, 0,
/*  180  */	        8, 168, 9, 0,
/*  181  */	        8, 176, 9, 0,
/*  182  */	        8, 184, 9, 0,
/*  183  */	        7, 192, 9, 0,
/*  184  */	        4, 200, 9, 0,
/*  185  */	        0, 208, 9, 0,
/*  186  */	        7, 216, 9, 0,
/*  187  */	        0, 224, 9, 0,
/*  188  */	        7, 232, 9, 0,
/*  189  */	        0, 240, 9, 0,
/*  190  */	        8, 248, 9, 0,
/*  191  */	        6, 0, 10, 0,
/*  192  */	        5, 8, 10, 0,
/*  193  */	        5, 16, 10, 0,
/*  194  */	        5, 24, 10, 0,
/*  195  */	        4, 32, 10, 0,
/*  196  */	        6, 40, 10, 0,
/*  197  */	        5, 48, 10, 0,
/*  198  */	        5, 56, 10, 0,
/*  199  */	        5, 64, 10, 0,
/*  200  */	        5, 72, 10, 0,
/*  201  */	        5, 80, 10, 0,
/*  202  */	        5, 88, 10, 0,
/*  203  */	        5, 96, 10, 0,
/*  204  */	        5, 104, 10, 0,
/*  205  */	        5, 112, 10, 0,
/*  206  */	        5, 120, 10, 0,
/*  207  */	        5, 128, 10, 0,
/*  208  */	        5, 136, 10, 0,
/*  209  */	        5, 144, 10, 0,
/*  210  */	        5, 152, 10, 0,
/*  211  */	        5, 160, 10, 0,
/*  212  */	        7, 168, 10, 0,
/*  213  */	        5, 176, 10, 0,
/*  214  */	        6, 184, 10, 0,
/*  215  */	        5, 192, 10, 0,
/*  216  */	        5, 200, 10, 0,
/*  217  */	        6, 208, 10, 0,
/*  218  */	        5, 216, 10, 0,
/*  219  */	        6, 224, 10, 0,
/*  220  */	        4, 232, 10, 0,
/*  221  */	        5, 240, 10, 0,
/*  222  */	        6, 248, 10, 0,
/*  223  */	        5, 0, 11, 0,
/*  224  */	        4, 8, 11, 0,
/*  225  */	        4, 16, 11, 0,
/*  226  */	        4, 24, 11, 0,
/*  227  */	        3, 32, 11, 0,
/*  228  */	        6, 40, 11, 0,
/*  229  */	        4, 48, 11, 0,
/*  230  */	        5, 56, 11, 0,
/*  231  */	        4, 64, 11, 0,
/*  232  */	        4, 72, 11, 0,
/*  233  */	        4, 80, 11, 0,
/*  234  */	        4, 88, 11, 0,
/*  235  */	        4, 96, 11, 0,
/*  236  */	        5, 104, 11, 0,
/*  237  */	        4, 112, 11, 0,
/*  238  */	        4, 120, 11, 0,
/*  239  */	        4, 128, 11, 0,
/*  240  */	        4, 136, 11, 0,
/*  241  */	        4, 144, 11, 0,
/*  242  */	        3, 152, 11, 0,
/*  243  */	        4, 160, 11, 0,
/*  244  */	        5, 168, 11, 0,
/*  245  */	        5, 176, 11, 0,
/*  246  */	        5, 184, 11, 0,
/*  247  */	        4, 192, 11, 0,
/*  248  */	        5, 200, 11, 0,
/*  249  */	        6, 208, 11, 0,
/*  250  */	        5, 216, 11, 0,
/*  251  */	        5, 224, 11, 0,
/*  252  */	        4, 232, 11, 0,
/*  253  */	        4, 240, 11, 0,
/*  254  */	        5, 248, 11, 0,
/*  255  */	        4, 0, 12, 0,

/* Map of characters */

/*  0  */	        0,0,0,0,0,0,0,0,
/*  1  */	        0,0,0,0,0,0,0,0,
/*  2  */	        0,0,0,0,0,0,0,0,
/*  3  */	        0,0,0,0,0,0,0,0,
/*  4  */	        0,0,0,0,0,0,0,0,
/*  5  */	        0,0,0,0,0,0,0,0,
/*  6  */	        0,0,0,0,0,0,0,0,
/*  7  */	        0,0,0,0,0,0,0,0,
/*  8  */	        0,0,0,0,0,0,0,0,
/*  9  */	        0,0,0,0,0,0,0,0,
/*  10  */	        0,0,0,0,0,0,0,0,
/*  11  */	        0,0,0,0,0,0,0,0,
/*  12  */	        0,0,0,0,0,0,0,0,
/*  13  */	        4,14,31,4,4,31,14,4,
/*  14  */	        124,130,5,9,17,1,1,130,
/*  15  */	        0,0,1,1,1,1,1,0,
/*  16  */	        0,0,0,0,0,0,0,0,
/*  17  */	        0,0,0,0,0,0,0,0,
/*  18  */	        0,0,0,0,0,0,0,0,
/*  19  */	        0,0,0,0,0,0,0,0,
/*  20  */	        0,0,0,0,0,0,0,0,
/*  21  */	        0,0,0,0,0,0,0,0,
/*  22  */	        0,0,0,0,0,0,0,0,
/*  23  */	        0,0,0,0,0,0,0,0,
/*  24  */	        0,0,0,0,0,0,0,0,
/*  25  */	        0,0,0,0,0,0,0,0,
/*  26  */	        0,0,0,0,0,0,0,0,
/*  27  */	        0,0,0,0,0,0,0,0,
/*  28  */	        0,0,0,0,0,0,0,0,
/*  29  */	        0,0,0,0,0,0,0,0,
/*  30  */	        124,0,0,0,0,0,0,0,
/*  31  */	        0,0,0,0,0,0,0,0,
/*  32  */	        0,0,0,0,0,0,0,0,
/*  33  */	        4,4,4,4,4,0,4,0,
/*  34  */	        5,5,0,0,0,0,0,0,
/*  35  */	        0,10,31,10,10,31,10,0,
/*  36  */	        0,4,31,5,31,20,31,4,
/*  37  */	        0,35,19,8,4,50,49,0,
/*  38  */	        0,4,10,4,26,9,22,0,
/*  39  */	        0,4,2,0,0,0,0,0,
/*  40  */	        2,2,1,1,1,2,2,0,
/*  41  */	        1,1,2,2,2,1,1,0,
/*  42  */	        0,0,5,2,5,0,0,0,
/*  43  */	        0,0,2,7,2,0,0,0,
/*  44  */	        0,0,0,0,0,8,4,0,
/*  45  */	        0,0,0,7,0,0,0,0,
/*  46  */	        0,0,0,0,0,0,1,0,
/*  47  */	        0,4,4,2,2,1,1,0,
/*  48  */	        15,9,9,9,9,9,15,0,
/*  49  */	        6,4,4,4,4,4,14,0,
/*  50  */	        15,8,8,15,1,1,15,0,
/*  51  */	        15,8,8,15,8,8,15,0,
/*  52  */	        9,9,9,15,8,8,8,0,
/*  53  */	        15,1,1,15,8,8,15,0,
/*  54  */	        15,1,1,15,9,9,15,0,
/*  55  */	        15,8,4,2,1,1,1,0,
/*  56  */	        15,9,9,15,9,9,15,0,
/*  57  */	        15,9,9,15,8,8,15,0,
/*  58  */	        0,1,0,0,0,1,0,0,
/*  59  */	        0,0,4,0,0,4,4,2,
/*  60  */	        0,36,18,9,18,36,0,0,
/*  61  */	        0,0,7,0,7,0,0,0,
/*  62  */	        0,9,18,36,18,9,0,0,
/*  63  */	        0,14,17,8,4,0,4,0,
/*  64  */	        9,0,15,9,15,1,15,0,
/*  65  */	        15,9,9,9,15,9,9,0,
/*  66  */	        7,9,9,7,9,9,7,0,
/*  67  */	        15,1,1,1,1,1,15,0,
/*  68  */	        7,9,9,9,9,9,7,0,
/*  69  */	        15,1,1,7,1,1,15,0,
/*  70  */	        15,1,1,7,1,1,1,0,
/*  71  */	        14,17,1,1,25,17,14,0,
/*  72  */	        17,17,17,31,17,17,17,0,
/*  73  */	        31,4,4,4,4,4,31,0,
/*  74  */	        8,8,8,8,9,9,6,0,
/*  75  */	        17,9,5,3,5,9,17,0,
/*  76  */	        1,1,1,1,1,9,15,0,
/*  77  */	        17,27,21,17,17,17,17,0,
/*  78  */	        17,17,19,21,21,25,17,0,
/*  79  */	        14,17,17,17,17,17,14,0,
/*  80  */	        15,17,17,17,15,1,1,0,
/*  81  */	        14,17,17,17,21,9,22,0,
/*  82  */	        15,17,17,17,15,9,17,0,
/*  83  */	        15,1,1,15,8,8,15,0,
/*  84  */	        31,4,4,4,4,4,4,0,
/*  85  */	        17,17,17,17,17,17,14,0,
/*  86  */	        17,17,17,17,17,10,4,0,
/*  87  */	        17,17,17,17,17,21,10,0,
/*  88  */	        17,10,4,4,4,10,17,0,
/*  89  */	        17,17,17,10,4,4,4,0,
/*  90  */	        31,16,8,4,2,1,31,0,
/*  91  */	        0,14,2,2,2,2,14,0,
/*  92  */	        0,0,1,2,4,8,16,0,
/*  93  */	        0,14,8,8,8,8,14,0,
/*  94  */	        0,4,14,21,4,4,4,0,
/*  95  */	        0,0,0,0,0,0,0,63,
/*  96  */	        6,2,7,2,2,2,2,0,
/*  97  */	        0,0,15,8,15,9,15,0,
/*  98  */	        1,1,15,9,9,9,15,0,
/*  99  */	        0,0,15,1,1,1,15,0,
/*  100  */	        8,8,15,9,9,9,15,0,
/*  101  */	        0,0,15,9,15,1,15,0,
/*  102  */	        6,2,7,2,2,2,2,0,
/*  103  */	        0,0,15,9,9,15,8,15,
/*  104  */	        1,1,15,9,9,9,9,0,
/*  105  */	        1,0,1,1,1,1,1,0,
/*  106  */	        0,8,0,8,8,8,9,6,
/*  107  */	        1,1,9,5,3,5,9,0,
/*  108  */	        1,1,1,1,1,1,3,0,
/*  109  */	        0,0,11,21,21,21,21,0,
/*  110  */	        0,0,7,9,9,9,9,0,
/*  111  */	        0,0,15,9,9,9,15,0,
/*  112  */	        0,0,15,9,9,15,1,1,
/*  113  */	        0,0,15,9,9,15,8,24,
/*  114  */	        0,0,7,1,1,1,1,0,
/*  115  */	        0,0,15,1,15,8,15,0,
/*  116  */	        2,2,7,2,2,2,6,0,
/*  117  */	        0,0,9,9,9,9,15,0,
/*  118  */	        0,0,17,17,10,10,4,0,
/*  119  */	        0,0,17,21,21,21,10,0,
/*  120  */	        0,0,17,10,4,10,17,0,
/*  121  */	        0,0,9,9,9,15,8,15,
/*  122  */	        0,0,31,8,4,2,31,0,
/*  123  */	        31,4,4,4,4,116,84,112,
/*  124  */	        15,1,1,7,1,113,33,32,
/*  125  */	        31,4,4,4,4,116,36,32,
/*  126  */	        0,0,6,73,48,0,0,0,
/*  127  */	        0,0,2,1,1,0,0,0,
/*  128  */	        0,4,6,7,6,4,0,0,
/*  129  */	        0,1,3,7,3,1,0,0,
/*  130  */	        15,33,49,249,49,33,15,0,
/*  131  */	        135,69,39,16,8,228,162,225,
/*  132  */	        62,34,54,54,28,8,0,0,
/*  133  */	        127,127,127,127,62,28,8,0,
/*  134  */	        0,248,140,222,220,248,0,0,
/*  135  */	        0,31,49,123,59,31,0,0,
/*  136  */	        65,34,20,8,20,34,65,0,
/*  137  */	        0,0,0,0,0,0,0,0,
/*  138  */	        62,34,42,34,62,0,0,0,
/*  139  */	        127,127,127,127,127,127,0,0,
/*  140  */	        124,130,1,1,17,9,5,130,
/*  141  */	        0,0,1,1,1,1,1,0,
/*  142  */	        7,2,2,18,26,18,18,16,
/*  143  */	        7,2,2,58,42,34,18,56,
/*  144  */	        0,8,8,8,8,127,0,0,
/*  145  */	        0,0,6,73,48,0,0,0,
/*  146  */	        0,0,127,0,107,0,0,0,
/*  147  */	        31,63,127,255,127,63,31,0,
/*  148  */	        248,252,254,255,254,252,248,0,
/*  149  */	        31,31,31,31,31,31,31,14,
/*  150  */	        14,31,31,31,31,31,31,31,
/*  151  */	        0,36,102,255,102,36,0,0,
/*  152  */	        0,0,0,0,0,0,0,0,
/*  153  */	        0,8,16,63,16,8,0,0,
/*  154  */	        0,4,4,31,4,4,0,0,
/*  155  */	        0,0,0,31,0,0,0,0,
/*  156  */	        124,0,0,0,0,0,0,0,
/*  157  */	        0,0,0,0,0,0,0,0,
/*  158  */	        5,5,5,37,53,37,35,32,
/*  159  */	        5,5,5,117,85,69,35,112,
/*  160  */	        20,20,84,85,65,65,66,36,
/*  161  */	        24,36,66,129,0,0,0,0,
/*  162  */	        0,0,0,0,129,66,36,24,
/*  163  */	        4,14,31,0,0,0,0,0,
/*  164  */	        31,14,4,0,0,0,0,0,
/*  165  */	        0,1,0,0,0,1,0,0,
/*  166  */	        15,8,8,28,8,8,120,0,
/*  167  */	        120,8,8,28,8,8,15,0,
/*  168  */	        6,9,9,6,0,0,0,0,
/*  169  */	        0,0,0,0,0,0,0,0,
/*  170  */	        124,130,65,33,17,1,1,130,
/*  171  */	        0,0,1,1,1,1,1,0,
/*  172  */	        124,130,1,1,17,33,65,130,
/*  173  */	        0,0,1,1,1,1,1,0,
/*  174  */	        3,15,63,255,255,255,255,255,
/*  175  */	        0,0,0,0,3,15,63,255,
/*  176  */	        2,2,2,2,2,2,127,0,
/*  177  */	        168,2,0,2,0,2,255,0,
/*  178  */	        62,65,65,65,65,65,128,0,
/*  179  */	        124,130,130,130,130,130,1,0,
/*  180  */	        21,64,0,64,0,64,255,0,
/*  181  */	        252,2,2,2,2,2,1,0,
/*  182  */	        63,64,64,64,64,64,128,0,
/*  183  */	        42,42,42,42,42,42,127,0,
/*  184  */	        9,0,15,9,15,1,15,0,
/*  185  */	        0,0,0,0,0,0,0,0,
/*  186  */	        124,0,0,0,0,0,0,0,
/*  187  */	        0,0,0,0,0,0,0,0,
/*  188  */	        124,0,0,0,0,0,0,0,
/*  189  */	        0,0,0,0,0,0,0,0,
/*  190  */	        255,255,255,255,63,15,3,0,
/*  191  */	        63,15,3,0,0,0,0,0,
/*  192  */	        31,17,17,31,17,17,17,0,
/*  193  */	        31,1,1,31,17,17,31,0,
/*  194  */	        31,17,17,15,17,17,31,0,
/*  195  */	        15,1,1,1,1,1,1,0,
/*  196  */	        30,18,18,18,18,18,63,33,
/*  197  */	        31,1,1,15,1,1,31,0,
/*  198  */	        21,21,21,14,21,21,21,0,
/*  199  */	        31,17,16,12,16,17,31,0,
/*  200  */	        17,25,21,19,17,17,17,0,
/*  201  */	        21,25,21,19,17,17,17,0,
/*  202  */	        17,9,5,3,5,9,17,0,
/*  203  */	        28,18,17,17,17,17,17,0,
/*  204  */	        17,27,21,17,17,17,17,0,
/*  205  */	        17,17,17,31,17,17,17,0,
/*  206  */	        31,17,17,17,17,17,31,0,
/*  207  */	        31,17,17,17,17,17,17,0,
/*  208  */	        31,17,17,17,31,1,1,0,
/*  209  */	        31,17,1,1,1,17,31,0,
/*  210  */	        31,4,4,4,4,4,4,0,
/*  211  */	        17,17,17,31,16,16,31,0,
/*  212  */	        127,73,73,73,127,8,8,0,
/*  213  */	        17,10,10,4,10,10,17,0,
/*  214  */	        17,17,17,17,17,17,63,32,
/*  215  */	        17,17,17,17,31,16,16,0,
/*  216  */	        21,21,21,21,21,21,31,0,
/*  217  */	        21,21,21,21,21,21,63,32,
/*  218  */	        3,2,2,30,18,18,30,0,
/*  219  */	        33,33,33,47,41,41,47,0,
/*  220  */	        1,1,1,15,9,9,15,0,
/*  221  */	        31,16,16,31,16,16,31,0,
/*  222  */	        61,37,37,39,37,37,61,0,
/*  223  */	        31,17,17,17,30,18,17,0,
/*  224  */	        0,0,15,8,15,9,15,0,
/*  225  */	        0,0,15,1,15,9,15,0,
/*  226  */	        0,0,15,9,7,9,15,0,
/*  227  */	        0,0,7,1,1,1,1,0,
/*  228  */	        0,0,30,18,18,18,63,33,
/*  229  */	        0,0,15,9,15,1,15,0,
/*  230  */	        0,0,21,21,14,21,21,0,
/*  231  */	        0,0,15,9,4,9,15,0,
/*  232  */	        0,0,9,13,11,9,9,0,
/*  233  */	        0,4,9,13,11,9,9,0,
/*  234  */	        0,0,9,5,3,5,9,0,
/*  235  */	        0,0,14,9,9,9,9,0,
/*  236  */	        0,0,17,27,21,17,17,0,
/*  237  */	        0,0,9,9,15,9,9,0,
/*  238  */	        0,0,15,9,9,9,15,0,
/*  239  */	        0,0,15,9,9,9,9,0,
/*  240  */	        0,0,15,9,9,15,1,1,
/*  241  */	        0,0,15,9,1,9,15,0,
/*  242  */	        0,0,7,2,2,2,2,0,
/*  243  */	        0,0,9,9,15,8,15,0,
/*  244  */	        0,0,31,21,21,31,4,0,
/*  245  */	        0,0,17,10,4,10,17,0,
/*  246  */	        0,0,9,9,9,9,31,16,
/*  247  */	        0,0,9,9,15,8,8,0,
/*  248  */	        0,0,21,21,21,21,31,0,
/*  249  */	        0,0,21,21,21,21,63,32,
/*  250  */	        0,0,3,2,30,18,30,0,
/*  251  */	        0,0,17,17,23,21,23,0,
/*  252  */	        0,0,1,1,15,9,15,0,
/*  253  */	        0,0,15,8,15,8,15,0,
/*  254  */	        0,0,29,21,23,21,29,0,
/*  255  */	        0,0,15,9,14,10,9,0
};
