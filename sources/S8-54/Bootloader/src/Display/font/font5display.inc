const BYTE font5display[3080] = {
/* Orient = 0x00, FontID = 0x00 */ 0x00, 0x00,
/* First character ID */           0x00, 0x00,
/* Last  character ID */           0xff, 0xff,
/* Height */                       0x05, 0x00,

/* Table of characters */

/* 0 */	    0, 8, 4, 0,
/* 1 */	    0, 16, 4, 0,
/* 2 */	    0, 24, 4, 0,
/* 3 */	    0, 32, 4, 0,
/* 4 */	    0, 40, 4, 0,
/* 5 */	    0, 48, 4, 0,
/* 6 */	    0, 56, 4, 0,
/* 7 */	    0, 64, 4, 0,
/* 8 */	    0, 72, 4, 0,
/* 9 */	    0, 80, 4, 0,
/* 10 */	    0, 88, 4, 0,
/* 11 */	    0, 96, 4, 0,
/* 12 */	    0, 104, 4, 0,
/* 13 */	    0, 112, 4, 0,
/* 14 */	    0, 120, 4, 0,
/* 15 */	    0, 128, 4, 0,
/* 16 */	    0, 136, 4, 0,
/* 17 */	    1, 144, 4, 0,
/* 18 */	    2, 152, 4, 0,
/* 19 */	    3, 160, 4, 0,
/* 20 */	    4, 168, 4, 0,
/* 21 */	    5, 176, 4, 0,
/* 22 */	    6, 184, 4, 0,
/* 23 */	    7, 192, 4, 0,
/* 24 */	    8, 200, 4, 0,
/* 25 */	    9, 208, 4, 0,
/* 26 */	    10, 216, 4, 0,
/* 27 */	    11, 224, 4, 0,
/* 28 */	    12, 232, 4, 0,
/* 29 */	    13, 240, 4, 0,
/* 30 */	    14, 248, 4, 0,
/* 31 */	    15, 0, 5, 0,
/* 32 */	    1, 8, 5, 0,
/* 33 */	    1, 16, 5, 0,
/* 34 */	    1, 24, 5, 0,
/* 35 */	    5, 32, 5, 0,
/* 36 */	    5, 40, 5, 0,
/* 37 */	    4, 48, 5, 0,
/* 38 */	    5, 56, 5, 0,
/* 39 */	    3, 64, 5, 0,
/* 40 */	    2, 72, 5, 0,
/* 41 */	    2, 80, 5, 0,
/* 42 */	    5, 88, 5, 0,
/* 43 */	    3, 96, 5, 0,
/* 44 */	    2, 104, 5, 0,
/* 45 */	    3, 112, 5, 0,
/* 46 */	    1, 120, 5, 0,
/* 47 */	    2, 128, 5, 0,
/* 48 */	    3, 136, 5, 0,
/* 49 */	    3, 144, 5, 0,
/* 50 */	    3, 152, 5, 0,
/* 51 */	    3, 160, 5, 0,
/* 52 */	    3, 168, 5, 0,
/* 53 */	    3, 176, 5, 0,
/* 54 */	    3, 184, 5, 0,
/* 55 */	    3, 192, 5, 0,
/* 56 */	    3, 200, 5, 0,
/* 57 */	    3, 208, 5, 0,
/* 58 */	    1, 216, 5, 0,
/* 59 */	    3, 224, 5, 0,
/* 60 */	    3, 232, 5, 0,
/* 61 */	    2, 240, 5, 0,
/* 62 */	    3, 248, 5, 0,
/* 63 */	    5, 0, 6, 0,
/* 64 */	    5, 8, 6, 0,
/* 65 */	    3, 16, 6, 0,
/* 66 */	    3, 24, 6, 0,
/* 67 */	    3, 32, 6, 0,
/* 68 */	    3, 40, 6, 0,
/* 69 */	    3, 48, 6, 0,
/* 70 */	    3, 56, 6, 0,
/* 71 */	    3, 64, 6, 0,
/* 72 */	    3, 72, 6, 0,
/* 73 */	    3, 80, 6, 0,
/* 74 */	    3, 88, 6, 0,
/* 75 */	    3, 96, 6, 0,
/* 76 */	    3, 104, 6, 0,
/* 77 */	    5, 112, 6, 0,
/* 78 */	    4, 120, 6, 0,
/* 79 */	    3, 128, 6, 0,
/* 80 */	    3, 136, 6, 0,
/* 81 */	    4, 144, 6, 0,
/* 82 */	    3, 152, 6, 0,
/* 83 */	    3, 160, 6, 0,
/* 84 */	    3, 168, 6, 0,
/* 85 */	    3, 176, 6, 0,
/* 86 */	    3, 184, 6, 0,
/* 87 */	    5, 192, 6, 0,
/* 88 */	    4, 200, 6, 0,
/* 89 */	    3, 208, 6, 0,
/* 90 */	    4, 216, 6, 0,
/* 91 */	    2, 224, 6, 0,
/* 92 */	    5, 232, 6, 0,
/* 93 */	    2, 240, 6, 0,
/* 94 */	    5, 248, 6, 0,
/* 95 */	    3, 0, 7, 0,
/* 96 */	    5, 8, 7, 0,
/* 97 */	    3, 16, 7, 0,
/* 98 */	    3, 24, 7, 0,
/* 99 */	    3, 32, 7, 0,
/* 100 */	    3, 40, 7, 0,
/* 101 */	    3, 48, 7, 0,
/* 102 */	    3, 56, 7, 0,
/* 103 */	    3, 64, 7, 0,
/* 104 */	    3, 72, 7, 0,
/* 105 */	    3, 80, 7, 0,
/* 106 */	    3, 88, 7, 0,
/* 107 */	    3, 96, 7, 0,
/* 108 */	    3, 104, 7, 0,
/* 109 */	    5, 112, 7, 0,
/* 110 */	    4, 120, 7, 0,
/* 111 */	    3, 128, 7, 0,
/* 112 */	    3, 136, 7, 0,
/* 113 */	    4, 144, 7, 0,
/* 114 */	    3, 152, 7, 0,
/* 115 */	    3, 160, 7, 0,
/* 116 */	    3, 168, 7, 0,
/* 117 */	    3, 176, 7, 0,
/* 118 */	    3, 184, 7, 0,
/* 119 */	    5, 192, 7, 0,
/* 120 */	    5, 200, 7, 0,
/* 121 */	    3, 208, 7, 0,
/* 122 */	    4, 216, 7, 0,
/* 123 */	    5, 224, 7, 0,
/* 124 */	    3, 232, 7, 0,
/* 125 */	    5, 240, 7, 0,
/* 126 */	    5, 248, 7, 0,
/* 127 */	    0, 0, 8, 0,
/* 128 */	    0, 8, 8, 0,
/* 129 */	    0, 16, 8, 0,
/* 130 */	    0, 24, 8, 0,
/* 131 */	    0, 32, 8, 0,
/* 132 */	    0, 40, 8, 0,
/* 133 */	    0, 48, 8, 0,
/* 134 */	    0, 56, 8, 0,
/* 135 */	    0, 64, 8, 0,
/* 136 */	    6, 72, 8, 0,
/* 137 */	    6, 80, 8, 0,
/* 138 */	    0, 88, 8, 0,
/* 139 */	    0, 96, 8, 0,
/* 140 */	    0, 104, 8, 0,
/* 141 */	    0, 112, 8, 0,
/* 142 */	    0, 120, 8, 0,
/* 143 */	    0, 128, 8, 0,
/* 144 */	    7, 136, 8, 0,
/* 145 */	    7, 144, 8, 0,
/* 146 */	    7, 152, 8, 0,
/* 147 */	    2, 160, 8, 0,
/* 148 */	    0, 168, 8, 0,
/* 149 */	    0, 176, 8, 0,
/* 150 */	    0, 184, 8, 0,
/* 151 */	    0, 192, 8, 0,
/* 152 */	    0, 200, 8, 0,
/* 153 */	    0, 208, 8, 0,
/* 154 */	    0, 216, 8, 0,
/* 155 */	    0, 224, 8, 0,
/* 156 */	    0, 232, 8, 0,
/* 157 */	    0, 240, 8, 0,
/* 158 */	    0, 248, 8, 0,
/* 159 */	    0, 0, 9, 0,
/* 160 */	    3, 8, 9, 0,
/* 161 */	    8, 16, 9, 0,
/* 162 */	    8, 24, 9, 0,
/* 163 */	    8, 32, 9, 0,
/* 164 */	    8, 40, 9, 0,
/* 165 */	    1, 48, 9, 0,
/* 166 */	    5, 56, 9, 0,
/* 167 */	    5, 64, 9, 0,
/* 168 */	    1, 72, 9, 0,
/* 169 */	    8, 80, 9, 0,
/* 170 */	    0, 88, 9, 0,
/* 171 */	    0, 96, 9, 0,
/* 172 */	    0, 104, 9, 0,
/* 173 */	    0, 112, 9, 0,
/* 174 */	    0, 120, 9, 0,
/* 175 */	    0, 128, 9, 0,
/* 176 */	    3, 136, 9, 0,
/* 177 */	    8, 144, 9, 0,
/* 178 */	    8, 152, 9, 0,
/* 179 */	    8, 160, 9, 0,
/* 180 */	    8, 168, 9, 0,
/* 181 */	    8, 176, 9, 0,
/* 182 */	    8, 184, 9, 0,
/* 183 */	    0, 192, 9, 0,
/* 184 */	    0, 200, 9, 0,
/* 185 */	    0, 208, 9, 0,
/* 186 */	    0, 216, 9, 0,
/* 187 */	    0, 224, 9, 0,
/* 188 */	    0, 232, 9, 0,
/* 189 */	    0, 240, 9, 0,
/* 190 */	    0, 248, 9, 0,
/* 191 */	    0, 0, 10, 0,
/* 192 */	    3, 8, 10, 0,
/* 193 */	    3, 16, 10, 0,
/* 194 */	    3, 24, 10, 0,
/* 195 */	    3, 32, 10, 0,
/* 196 */	    5, 40, 10, 0,
/* 197 */	    3, 48, 10, 0,
/* 198 */	    4, 56, 10, 0,
/* 199 */	    3, 64, 10, 0,
/* 200 */	    4, 72, 10, 0,
/* 201 */	    4, 80, 10, 0,
/* 202 */	    3, 88, 10, 0,
/* 203 */	    3, 96, 10, 0,
/* 204 */	    5, 104, 10, 0,
/* 205 */	    3, 112, 10, 0,
/* 206 */	    3, 120, 10, 0,
/* 207 */	    3, 128, 10, 0,
/* 208 */	    3, 136, 10, 0,
/* 209 */	    3, 144, 10, 0,
/* 210 */	    3, 152, 10, 0,
/* 211 */	    3, 160, 10, 0,
/* 212 */	    5, 168, 10, 0,
/* 213 */	    4, 176, 10, 0,
/* 214 */	    4, 184, 10, 0,
/* 215 */	    3, 192, 10, 0,
/* 216 */	    5, 200, 10, 0,
/* 217 */	    6, 208, 10, 0,
/* 218 */	    4, 216, 10, 0,
/* 219 */	    5, 224, 10, 0,
/* 220 */	    3, 232, 10, 0,
/* 221 */	    3, 240, 10, 0,
/* 222 */	    5, 248, 10, 0,
/* 223 */	    4, 0, 11, 0,
/* 224 */	    3, 8, 11, 0,
/* 225 */	    3, 16, 11, 0,
/* 226 */	    3, 24, 11, 0,
/* 227 */	    3, 32, 11, 0,
/* 228 */	    5, 40, 11, 0,
/* 229 */	    3, 48, 11, 0,
/* 230 */	    4, 56, 11, 0,
/* 231 */	    3, 64, 11, 0,
/* 232 */	    4, 72, 11, 0,
/* 233 */	    4, 80, 11, 0,
/* 234 */	    3, 88, 11, 0,
/* 235 */	    3, 96, 11, 0,
/* 236 */	    5, 104, 11, 0,
/* 237 */	    3, 112, 11, 0,
/* 238 */	    3, 120, 11, 0,
/* 239 */	    3, 128, 11, 0,
/* 240 */	    3, 136, 11, 0,
/* 241 */	    3, 144, 11, 0,
/* 242 */	    3, 152, 11, 0,
/* 243 */	    3, 160, 11, 0,
/* 244 */	    5, 168, 11, 0,
/* 245 */	    4, 176, 11, 0,
/* 246 */	    4, 184, 11, 0,
/* 247 */	    3, 192, 11, 0,
/* 248 */	    5, 200, 11, 0,
/* 249 */	    6, 208, 11, 0,
/* 250 */	    4, 216, 11, 0,
/* 251 */	    5, 224, 11, 0,
/* 252 */	    3, 232, 11, 0,
/* 253 */	    3, 240, 11, 0,
/* 254 */	    5, 248, 11, 0,
/* 255 */	    4, 0, 12, 0,

/* Map of characters */

/* 0 */	        0,0,0,0,0,0,0,0,
/* 1 */	        0,0,0,0,0,0,0,0,
/* 2 */	        0,0,0,0,0,0,0,0,
/* 3 */	        0,0,0,0,0,0,0,0,
/* 4 */	        0,0,0,0,0,0,0,0,
/* 5 */	        0,0,0,0,0,0,0,0,
/* 6 */	        0,0,0,0,0,0,0,0,
/* 7 */	        0,0,0,0,0,0,0,0,
/* 8 */	        0,0,0,0,0,0,0,0,
/* 9 */	        0,0,0,0,0,0,0,0,
/* 10 */	        0,0,0,0,0,0,0,0,
/* 11 */	        0,0,0,0,0,0,0,0,
/* 12 */	        0,0,0,0,0,0,0,0,
/* 13 */	        0,0,0,0,0,0,0,0,
/* 14 */	        0,0,0,0,0,0,0,0,
/* 15 */	        0,0,0,0,0,0,0,0,
/* 16 */	        0,0,0,0,0,0,0,0,
/* 17 */	        0,0,0,0,0,0,0,0,
/* 18 */	        0,0,0,0,0,0,0,0,
/* 19 */	        0,0,0,0,0,0,0,0,
/* 20 */	        0,0,0,0,0,0,0,0,
/* 21 */	        0,0,0,0,0,0,0,0,
/* 22 */	        0,0,0,0,0,0,0,0,
/* 23 */	        0,0,0,0,0,0,0,0,
/* 24 */	        0,0,0,0,0,0,0,0,
/* 25 */	        0,0,0,0,0,0,0,0,
/* 26 */	        0,0,0,0,0,0,0,0,
/* 27 */	        0,0,0,0,0,0,0,0,
/* 28 */	        0,0,0,0,0,0,0,0,
/* 29 */	        0,0,0,0,0,0,0,0,
/* 30 */	        0,0,0,0,0,0,0,0,
/* 31 */	        0,0,0,0,0,0,0,0,
/* 32 */	        0,0,0,0,0,0,0,0,
/* 33 */	        1,1,1,0,1,0,0,0,
/* 34 */	        0,0,0,0,1,0,0,0,
/* 35 */	        0,10,31,10,10,31,10,0,
/* 36 */	        0,4,31,5,31,20,31,4,
/* 37 */	        9,4,6,2,9,0,0,0,
/* 38 */	        0,4,10,4,26,9,22,0,
/* 39 */	        0,4,2,0,0,0,0,0,
/* 40 */	        2,1,1,1,2,0,0,0,
/* 41 */	        1,2,2,2,1,0,0,0,
/* 42 */	        0,0,10,4,31,4,10,0,
/* 43 */	        0,2,7,2,0,0,0,0,
/* 44 */	        0,0,0,2,1,0,0,0,
/* 45 */	        0,0,7,0,0,0,0,0,
/* 46 */	        0,0,0,0,1,0,0,0,
/* 47 */	        0,2,2,1,1,0,0,0,
/* 48 */	        7,5,5,5,7,0,0,0,
/* 49 */	        3,2,2,2,7,0,0,0,
/* 50 */	        7,4,7,1,7,0,0,0,
/* 51 */	        7,4,7,4,7,0,0,0,
/* 52 */	        5,5,7,4,4,0,0,0,
/* 53 */	        7,1,7,4,7,0,0,0,
/* 54 */	        7,1,7,5,7,0,0,0,
/* 55 */	        7,4,2,1,1,0,0,0,
/* 56 */	        7,5,7,5,7,0,0,0,
/* 57 */	        7,5,7,4,7,0,0,0,
/* 58 */	        1,0,0,0,1,0,0,0,
/* 59 */	        0,0,4,0,0,4,4,2,
/* 60 */	        5,5,0,0,0,0,0,0,
/* 61 */	        0,3,0,3,0,0,0,0,
/* 62 */	        1,2,4,2,1,0,0,0,
/* 63 */	        0,14,17,8,4,0,4,0,
/* 64 */	        0,14,25,21,13,1,14,0,
/* 65 */	        7,5,7,5,5,0,0,0,
/* 66 */	        7,5,3,5,7,0,0,0,
/* 67 */	        7,1,1,1,7,0,0,0,
/* 68 */	        3,5,5,5,3,0,0,0,
/* 69 */	        7,1,7,1,7,0,0,0,
/* 70 */	        7,1,7,1,1,0,0,0,
/* 71 */	        7,1,1,5,7,0,0,0,
/* 72 */	        5,5,7,5,5,0,0,0,
/* 73 */	        7,2,2,2,7,0,0,0,
/* 74 */	        4,4,4,5,7,0,0,0,
/* 75 */	        5,3,1,3,5,0,0,0,
/* 76 */	        1,1,1,1,7,0,0,0,
/* 77 */	        17,27,21,17,17,0,0,0,
/* 78 */	        9,11,13,9,9,0,0,0,
/* 79 */	        7,5,5,5,7,0,0,0,
/* 80 */	        7,5,7,1,1,0,0,0,
/* 81 */	        7,5,5,13,7,0,0,0,
/* 82 */	        7,5,7,3,5,0,0,0,
/* 83 */	        7,1,7,4,7,0,0,0,
/* 84 */	        7,2,2,2,2,0,0,0,
/* 85 */	        5,5,5,5,7,0,0,0,
/* 86 */	        5,5,5,7,2,0,0,0,
/* 87 */	        17,17,17,21,10,0,0,0,
/* 88 */	        9,6,2,6,9,0,0,0,
/* 89 */	        5,5,5,2,2,0,0,0,
/* 90 */	        15,8,4,2,15,0,0,0,
/* 91 */	        3,1,1,1,3,0,0,0,
/* 92 */	        0,0,1,2,4,8,16,0,
/* 93 */	        3,2,2,2,3,0,0,0,
/* 94 */	        0,4,14,21,4,4,4,0,
/* 95 */	        0,0,0,0,7,0,0,0,
/* 96 */	        0,12,18,7,2,2,31,0,
/* 97 */	        7,5,7,5,5,0,0,0,
/* 98 */	        7,5,3,5,7,0,0,0,
/* 99 */	        7,1,1,1,7,0,0,0,
/* 100 */	        3,5,5,5,3,0,0,0,
/* 101 */	        7,1,7,1,7,0,0,0,
/* 102 */	        7,1,3,1,1,0,0,0,
/* 103 */	        7,1,1,5,7,0,0,0,
/* 104 */	        5,5,7,5,5,0,0,0,
/* 105 */	        7,2,2,2,7,0,0,0,
/* 106 */	        4,4,4,5,7,0,0,0,
/* 107 */	        5,3,1,3,5,0,0,0,
/* 108 */	        1,1,1,1,7,0,0,0,
/* 109 */	        17,27,21,17,17,0,0,0,
/* 110 */	        9,11,13,9,9,0,0,0,
/* 111 */	        7,5,5,5,7,0,0,0,
/* 112 */	        7,5,7,1,1,0,0,0,
/* 113 */	        7,5,5,13,7,0,0,0,
/* 114 */	        7,5,7,3,5,0,0,0,
/* 115 */	        7,1,7,4,7,0,0,0,
/* 116 */	        7,2,2,2,2,0,0,0,
/* 117 */	        5,5,5,5,7,0,0,0,
/* 118 */	        5,5,5,5,2,0,0,0,
/* 119 */	        17,17,17,21,10,0,0,0,
/* 120 */	        17,10,4,10,17,0,0,0,
/* 121 */	        5,5,7,2,2,0,0,0,
/* 122 */	        15,8,4,2,15,0,0,0,
/* 123 */	        0,28,4,3,4,4,28,0,
/* 124 */	        0,4,4,4,4,4,4,0,
/* 125 */	        0,7,4,24,4,4,7,0,
/* 126 */	        0,20,10,0,0,0,0,0,
/* 127 */	        0,0,0,0,0,0,0,0,
/* 128 */	        0,0,0,0,0,0,0,0,
/* 129 */	        0,0,0,0,0,0,0,0,
/* 130 */	        0,0,0,0,0,0,0,0,
/* 131 */	        0,0,0,0,0,0,0,0,
/* 132 */	        0,0,0,0,0,0,0,0,
/* 133 */	        0,0,0,0,0,0,0,0,
/* 134 */	        0,0,0,0,0,0,0,0,
/* 135 */	        0,0,0,0,0,0,0,0,
/* 136 */	        0,0,0,63,0,0,0,0,
/* 137 */	        63,0,63,0,0,0,0,0,
/* 138 */	        0,0,0,0,0,0,0,0,
/* 139 */	        0,0,0,0,0,0,0,0,
/* 140 */	        0,0,0,0,0,0,0,0,
/* 141 */	        0,0,0,0,0,0,0,0,
/* 142 */	        0,0,0,0,0,0,0,0,
/* 143 */	        0,0,0,0,0,0,0,0,
/* 144 */	        0,8,8,8,8,127,0,0,
/* 145 */	        0,0,6,73,48,0,0,0,
/* 146 */	        0,0,127,0,107,0,0,0,
/* 147 */	        0,0,3,0,0,0,0,0,
/* 148 */	        0,0,0,0,0,0,0,0,
/* 149 */	        0,0,0,0,0,0,0,0,
/* 150 */	        0,0,0,0,0,0,0,0,
/* 151 */	        0,0,0,0,0,0,0,0,
/* 152 */	        0,0,0,0,0,0,0,0,
/* 153 */	        0,0,0,0,0,0,0,0,
/* 154 */	        0,0,0,0,0,0,0,0,
/* 155 */	        0,0,0,0,0,0,0,0,
/* 156 */	        0,0,0,0,0,0,0,0,
/* 157 */	        0,0,0,0,0,0,0,0,
/* 158 */	        0,0,0,0,0,0,0,0,
/* 159 */	        0,0,0,0,0,0,0,0,
/* 160 */	        0,7,7,1,7,0,0,0,
/* 161 */	        24,36,66,129,0,0,0,0,
/* 162 */	        0,0,0,0,129,66,36,24,
/* 163 */	        24,60,126,255,0,0,0,0,
/* 164 */	        0,0,0,0,255,126,60,24,
/* 165 */	        1,0,0,0,1,0,0,0,
/* 166 */	        7,4,14,4,28,0,0,0,
/* 167 */	        28,4,14,4,7,0,0,0,
/* 168 */	        1,0,0,0,1,0,0,0,
/* 169 */	        15,33,49,249,49,33,15,0,
/* 170 */	        0,0,0,0,0,0,0,0,
/* 171 */	        0,0,0,0,0,0,0,0,
/* 172 */	        0,0,0,0,0,0,0,0,
/* 173 */	        0,0,0,0,0,0,0,0,
/* 174 */	        0,0,0,0,0,0,0,0,
/* 175 */	        0,0,0,0,0,0,0,0,
/* 176 */	        0,7,7,1,7,0,0,0,
/* 177 */	        0,0,0,0,0,0,255,0,
/* 178 */	        62,65,65,65,65,65,128,0,
/* 179 */	        124,130,130,130,130,130,1,0,
/* 180 */	        0,0,0,0,0,0,255,0,
/* 181 */	        252,2,2,2,2,2,1,0,
/* 182 */	        63,64,64,64,64,64,128,0,
/* 183 */	        0,0,0,0,0,0,0,0,
/* 184 */	        0,0,0,0,0,0,0,0,
/* 185 */	        0,0,0,0,0,0,0,0,
/* 186 */	        0,0,0,0,0,0,0,0,
/* 187 */	        0,0,0,0,0,0,0,0,
/* 188 */	        0,0,0,0,0,0,0,0,
/* 189 */	        0,0,0,0,0,0,0,0,
/* 190 */	        0,0,0,0,0,0,0,0,
/* 191 */	        0,0,0,0,0,0,0,0,
/* 192 */	        7,5,7,5,5,0,0,0,
/* 193 */	        7,1,7,5,7,0,0,0,
/* 194 */	        7,5,3,5,7,0,0,0,
/* 195 */	        7,1,1,1,1,0,0,0,
/* 196 */	        14,10,10,31,17,0,0,0,
/* 197 */	        7,1,7,1,7,0,0,0,
/* 198 */	        9,6,15,6,9,0,0,0,
/* 199 */	        7,4,2,4,7,0,0,0,
/* 200 */	        9,13,11,9,9,0,0,0,
/* 201 */	        9,13,11,9,9,0,0,0,
/* 202 */	        5,3,1,3,5,0,0,0,
/* 203 */	        6,5,5,5,5,0,0,0,
/* 204 */	        17,27,21,17,17,0,0,0,
/* 205 */	        5,5,7,5,5,0,0,0,
/* 206 */	        7,5,5,5,7,0,0,0,
/* 207 */	        7,5,5,5,5,0,0,0,
/* 208 */	        7,5,7,1,1,0,0,0,
/* 209 */	        7,1,1,1,7,0,0,0,
/* 210 */	        7,2,2,2,2,0,0,0,
/* 211 */	        5,5,7,4,7,0,0,0,
/* 212 */	        31,21,21,31,4,0,0,0,
/* 213 */	        9,6,6,6,9,0,0,0,
/* 214 */	        5,5,5,5,15,0,0,0,
/* 215 */	        5,5,7,4,4,0,0,0,
/* 216 */	        21,21,21,21,31,0,0,0,
/* 217 */	        21,21,21,21,63,0,0,0,
/* 218 */	        3,2,14,10,14,0,0,0,
/* 219 */	        17,17,23,21,23,0,0,0,
/* 220 */	        1,1,7,5,7,0,0,0,
/* 221 */	        7,4,7,4,7,0,0,0,
/* 222 */	        29,21,23,21,29,0,0,0,
/* 223 */	        15,9,15,10,9,0,0,0,
/* 224 */	        7,5,7,5,5,0,0,0,
/* 225 */	        7,1,7,5,7,0,0,0,
/* 226 */	        7,5,3,5,7,0,0,0,
/* 227 */	        7,1,1,1,1,0,0,0,
/* 228 */	        14,10,10,31,17,0,0,0,
/* 229 */	        7,1,7,1,7,0,0,0,
/* 230 */	        9,6,15,6,9,0,0,0,
/* 231 */	        7,4,2,4,7,0,0,0,
/* 232 */	        9,13,11,9,9,0,0,0,
/* 233 */	        9,13,11,9,9,0,0,0,
/* 234 */	        5,3,1,3,5,0,0,0,
/* 235 */	        6,5,5,5,5,0,0,0,
/* 236 */	        17,27,21,17,17,0,0,0,
/* 237 */	        5,5,7,5,5,0,0,0,
/* 238 */	        7,5,5,5,7,0,0,0,
/* 239 */	        7,5,5,5,5,0,0,0,
/* 240 */	        7,5,7,1,1,0,0,0,
/* 241 */	        7,1,1,1,7,0,0,0,
/* 242 */	        7,2,2,2,2,0,0,0,
/* 243 */	        5,5,7,4,7,0,0,0,
/* 244 */	        31,21,21,31,4,0,0,0,
/* 245 */	        9,6,6,6,9,0,0,0,
/* 246 */	        5,5,5,5,15,0,0,0,
/* 247 */	        5,5,7,4,4,0,0,0,
/* 248 */	        21,21,21,21,31,0,0,0,
/* 249 */	        21,21,21,21,63,0,0,0,
/* 250 */	        3,2,14,10,14,0,0,0,
/* 251 */	        17,17,23,21,23,0,0,0,
/* 252 */	        1,1,7,5,7,0,0,0,
/* 253 */	        7,4,7,4,7,0,0,0,
/* 254 */	        29,21,23,21,29,0,0,0,
/* 255 */	        15,9,15,10,9,0,0,0
};
