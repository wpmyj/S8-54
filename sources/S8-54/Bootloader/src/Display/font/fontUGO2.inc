#include "font.h"
const Font fontUGO2 = {
	8, {
/*0*/		{ 0, { 0,	0,	0,	0,	0,	0,	0,	0	} },	
/*1*/		{ 0, { 0,	0,	0,	0,	0,	0,	0,	0	} },	
/*2*/		{ 0, { 0,	0,	0,	0,	0,	0,	0,	0	} },	
/*3*/		{ 0, { 0,	0,	0,	0,	0,	0,	0,	0	} },	
/*4*/		{ 0, { 0,	0,	0,	0,	0,	0,	0,	0	} },	
/*5*/		{ 0, { 0,	0,	0,	0,	0,	0,	0,	0	} },	
/*6*/		{ 0, { 0,	0,	0,	0,	0,	0,	0,	0	} },	
/*7*/		{ 0, { 0,	0,	0,	0,	0,	0,	0,	0	} },	
/*8*/		{ 0, { 0,	0,	0,	0,	0,	0,	0,	0	} },	
/*9*/		{ 0, { 0,	0,	0,	0,	0,	0,	0,	0	} },	
/*10*/		{ 0, { 0,	0,	0,	0,	0,	0,	0,	0	} },	
/*11*/		{ 0, { 0,	0,	0,	0,	0,	0,	0,	0	} },	
/*12*/		{ 0, { 0,	0,	0,	0,	0,	0,	0,	0	} },	
/*13*/		{ 0, { 0,	0,	0,	0,	0,	0,	0,	0	} },	
/*14*/		{ 0, { 0,	0,	0,	0,	0,	0,	0,	0	} },	
/*15*/		{ 0, { 0,	0,	0,	0,	0,	0,	0,	0	} },	
/*16*/		{ 8, { 255,	128,	128,	128,	128,	128,	128,	0	} },	
/*17*/		{ 8, { 128,	128,	128,	128,	128,	128,	255,	0	} },	
/*18*/		{ 8, { 255,	255,	255,	255,	128,	128,	128,	0	} },	
/*19*/		{ 8, { 1,	1,	1,	255,	255,	255,	255,	0	} },	
/*20*/		{ 0, { 0,	0,	0,	0,	0,	0,	0,	0	} },	
/*21*/		{ 0, { 0,	0,	0,	0,	0,	0,	0,	0	} },	
/*22*/		{ 0, { 0,	0,	0,	0,	0,	0,	0,	0	} },	
/*23*/		{ 0, { 0,	0,	0,	0,	0,	0,	0,	0	} },	
/*24*/		{ 0, { 0,	0,	0,	0,	0,	0,	0,	0	} },	
/*25*/		{ 0, { 0,	0,	0,	0,	0,	0,	0,	0	} },	
/*26*/		{ 0, { 0,	0,	0,	0,	0,	0,	0,	0	} },	
/*27*/		{ 0, { 0,	0,	0,	0,	0,	0,	0,	0	} },	
/*28*/		{ 0, { 0,	0,	0,	0,	0,	0,	0,	0	} },	
/*29*/		{ 0, { 0,	0,	0,	0,	0,	0,	0,	0	} },	
/*30*/		{ 0, { 0,	0,	0,	0,	0,	0,	0,	0	} },	
/*31*/		{ 0, { 0,	0,	0,	0,	0,	0,	0,	0	} },	
/*32*/		{ 8, { 0,	0,	0,	8,	24,	40,	72,	143	} },	
/*33*/		{ 8, { 0,	0,	0,	0,	0,	0,	0,	255	} },	
/*34*/		{ 8, { 0,	0,	0,	0,	8,	4,	2,	1	} },	
/*35*/		{ 4, { 0,	0,	0,	0,	16,	32,	64,	128	} },	
/*36*/		{ 7, { 0,	0,	0,	0,	18,	34,	66,	250	} },	
/*37*/		{ 7, { 0,	0,	0,	0,	144,	136,	132,	190	} },	
/*38*/		{ 8, { 15,	8,	8,	15,	1,	1,	1,	1	} },	
/*39*/		{ 3, { 224,	32,	32,	224,	0,	0,	0,	0	} },	
/*40*/		{ 8, { 0,	15,	16,	32,	64,	64,	64,	64	} },	
/*41*/		{ 4, { 0,	128,	64,	32,	16,	16,	16,	16	} },	
/*42*/		{ 8, { 0,	123,	24,	40,	72,	64,	64,	0	} },	
/*43*/		{ 4, { 0,	144,	80,	48,	240,	0,	16,	16	} },	
/*44*/		{ 8, { 0,	63,	80,	80,	80,	80,	80,	80	} },	
/*45*/		{ 7, { 0,	252,	10,	10,	10,	10,	10,	10	} },	
/*46*/		{ 8, { 0,	3,	6,	12,	25,	51,	102,	204	} },	
/*47*/		{ 8, { 0,	51,	102,	204,	152,	48,	96,	192	} },	
/*48*/		{ 5, { 72,	40,	24,	8,	0,	0,	0,	0	} },	
/*49*/		{ 0, { 0,	0,	0,	0,	0,	0,	0,	0	} },	
/*50*/		{ 8, { 1,	2,	4,	8,	0,	0,	0,	0	} },	
/*51*/		{ 4, { 128,	64,	32,	16,	0,	0,	0,	0	} },	
/*52*/		{ 7, { 66,	34,	18,	0,	0,	0,	0,	0	} },	
/*53*/		{ 6, { 132,	136,	144,	0,	0,	0,	0,	0	} },	
/*54*/		{ 8, { 1,	1,	9,	5,	3,	1,	0,	0	} },	
/*55*/		{ 3, { 0,	0,	32,	64,	128,	0,	0,	0	} },	
/*56*/		{ 8, { 64,	32,	16,	15,	0,	0,	0,	0	} },	
/*57*/		{ 4, { 16,	32,	64,	128,	0,	0,	0,	0	} },	
/*58*/		{ 7, { 120,	96,	80,	78,	0,	0,	0,	0	} },	
/*59*/		{ 4, { 144,	160,	192,	240,	0,	0,	0,	0	} },	
/*60*/		{ 8, { 80,	95,	64,	64,	65,	65,	63,	0	} },	
/*61*/		{ 7, { 10,	250,	2,	2,	242,	18,	252,	0	} },	
/*62*/		{ 8, { 204,	102,	51,	25,	12,	6,	3,	0	} },	
/*63*/		{ 8, { 192,	96,	48,	152,	204,	102,	51,	0	} },	
/*64*/		{ 8, { 0,	0,	18,	18,	18,	127,	64,	64	} },	
/*65*/		{ 7, { 0,	0,	72,	72,	72,	254,	2,	2	} },	
/*66*/		{ 8, { 7,	8,	8,	31,	32,	32,	32,	33	} },	
/*67*/		{ 6, { 224,	16,	16,	248,	4,	4,	132,	196	} },	
/*68*/		{ 8, { 0,	0,	48,	56,	28,	14,	7,	3	} },	
/*69*/		{ 6, { 0,	0,	12,	28,	56,	112,	224,	192	} },	
/*70*/		{ 8, { 0,	0,	0,	0,	30,	33,	32,	33	} },	
/*71*/		{ 7, { 0,	0,	0,	0,	0,	252,	2,	254	} },	
/*72*/		{ 8, { 0,	0,	8,	20,	34,	65,	227,	20	} },	
/*73*/		{ 1, { 0,	0,	0,	0,	0,	0,	128,	0	} },	
/*74*/		{ 8, { 0,	127,	128,	127,	0,	0,	0,	0	} },	
/*75*/		{ 5, { 0,	240,	8,	200,	40,	40,	40,	40	} },	
/*76*/		{ 8, { 1,	2,	4,	8,	16,	32,	64,	255	} },	
/*77*/		{ 7, { 0,	128,	64,	32,	16,	8,	4,	254	} },	
/*78*/		{ 8, { 255,	64,	32,	16,	8,	4,	2,	1	} },	
/*79*/		{ 7, { 254,	4,	8,	16,	32,	64,	128,	0	} },	
/*80*/		{ 8, { 64,	64,	127,	18,	18,	18,	0,	0	} },	
/*81*/		{ 7, { 2,	2,	254,	72,	72,	72,	0,	0	} },	
/*82*/		{ 8, { 44,	44,	34,	33,	32,	32,	32,	31	} },	
/*83*/		{ 6, { 132,	180,	180,	196,	132,	4,	4,	248	} },	
/*84*/		{ 8, { 3,	7,	14,	28,	56,	48,	0,	0	} },	
/*85*/		{ 6, { 192,	224,	112,	56,	28,	12,	0,	0	} },	
/*86*/		{ 8, { 34,	36,	40,	48,	48,	31,	0,	0	} },	
/*87*/		{ 8, { 1,	1,	1,	2,	4,	248,	0,	0	} },	
/*88*/		{ 8, { 20,	20,	20,	19,	16,	15,	0,	0	} },	
/*89*/		{ 8, { 0,	0,	0,	254,	1,	254,	0,	0	} },	
/*90*/		{ 8, { 1,	0,	0,	0,	0,	0,	0,	0	} },	
/*91*/		{ 8, { 199,	130,	68,	40,	16,	0,	0,	0	} },	
/*92*/		{ 0, { 0,	0,	0,	0,	0,	0,	0,	0	} },	
/*93*/		{ 0, { 0,	0,	0,	0,	0,	0,	0,	0	} },	
/*94*/		{ 0, { 0,	0,	0,	0,	0,	0,	0,	0	} },	
/*95*/		{ 0, { 0,	0,	0,	0,	0,	0,	0,	0	} },	
/*96*/		{ 8, { 0,	0,	24,	24,	30,	30,	25,	25	} },	
/*97*/		{ 5, { 0,	0,	24,	24,	120,	120,	152,	152	} },	
/*98*/		{ 8, { 12,	18,	10,	74,	177,	128,	113,	10	} },	
/*99*/		{ 8, { 24,	20,	18,	33,	71,	136,	16,	32	} },	
/*100*/		{ 8, { 0,	0,	0,	0,	0,	0,	0,	255	} },	
/*101*/		{ 8, { 0,	0,	0,	16,	24,	20,	18,	241	} },	
/*102*/		{ 8, { 0,	127,	65,	65,	65,	65,	65,	193	} },	
/*103*/		{ 0, { 0,	0,	0,	0,	0,	0,	0,	0	} },	
/*104*/		{ 8, { 128,	127,	97,	81,	73,	69,	67,	193	} },	
/*105*/		{ 8, { 1,	2,	4,	8,	16,	32,	64,	128	} },	
/*106*/		{ 8, { 0,	0,	0,	0,	251,	34,	34,	35	} },	
/*107*/		{ 7, { 0,	0,	0,	0,	210,	20,	24,	144	} },	
/*108*/		{ 8, { 0,	0,	0,	0,	121,	74,	10,	18	} },	
/*109*/		{ 7, { 0,	0,	0,	0,	222,	82,	82,	82	} },	
/*110*/		{ 8, { 0,	136,	152,	168,	207,	168,	152,	136	} },	
/*111*/		{ 8, { 0,	0,	0,	0,	255,	0,	0,	0	} },	
/*112*/		{ 5, { 24,	24,	24,	24,	0,	0,	0,	0	} },	
/*113*/		{ 5, { 24,	24,	24,	24,	0,	0,	0,	0	} },	
/*114*/		{ 8, { 4,	8,	17,	226,	132,	72,	40,	24	} },	
/*115*/		{ 8, { 80,	142,	1,	141,	82,	80,	72,	48	} },	
/*116*/		{ 0, { 0,	0,	0,	0,	0,	0,	0,	0	} },	
/*117*/		{ 7, { 18,	20,	24,	16,	0,	0,	0,	0	} },	
/*118*/		{ 8, { 1,	1,	1,	1,	1,	1,	1,	0	} },	
/*119*/		{ 8, { 7,	4,	4,	4,	4,	4,	252,	0	} },	
/*120*/		{ 8, { 1,	3,	5,	9,	17,	33,	65,	128	} },	
/*121*/		{ 8, { 135,	68,	36,	20,	12,	4,	254,	1	} },	
/*122*/		{ 8, { 34,	34,	35,	0,	0,	0,	0,	0	} },	
/*123*/		{ 7, { 24,	20,	210,	0,	0,	0,	0,	0	} },	
/*124*/		{ 8, { 11,	74,	122,	0,	0,	0,	0,	0	} },	
/*125*/		{ 7, { 210,	82,	82,	0,	0,	0,	0,	0	} },	
/*126*/		{ 8, { 0,	0,	0,	255,	0,	0,	0,	0	} },	
/*127*/		{ 8, { 17,	25,	21,	243,	21,	25,	17,	0	} },	
/*128*/		{ 8, { 127,	128,	128,	128,	128,	128,	128,	128	} },	
/*129*/		{ 6, { 224,	16,	28,	20,	20,	20,	28,	16	} },	
/*130*/		{ 8, { 31,	17,	31,	4,	255,	32,	251,	138	} },	
/*131*/		{ 3, { 0,	0,	0,	0,	224,	128,	224,	32	} },	
/*132*/		{ 8, { 3,	7,	8,	144,	255,	130,	1,	0	} },	
/*133*/		{ 6, { 0,	0,	0,	0,	252,	0,	56,	248	} },	
/*134*/		{ 0, { 0,	0,	0,	0,	0,	0,	0,	0	} },	
/*135*/		{ 8, { 0,	254,	130,	130,	130,	130,	130,	131	} },	
/*136*/		{ 1, { 128,	128,	128,	128,	128,	128,	128,	128	} },	
/*137*/		{ 8, { 1,	255,	135,	139,	147,	163,	195,	131	} },	
/*138*/		{ 8, { 128,	64,	32,	17,	10,	4,	10,	17	} },	
/*139*/		{ 3, { 32,	64,	128,	0,	0,	0,	0,	0	} },	
/*140*/		{ 0, { 0,	0,	0,	0,	0,	0,	0,	0	} },	
/*141*/		{ 0, { 0,	0,	0,	0,	0,	0,	0,	0	} },	
/*142*/		{ 0, { 0,	0,	0,	0,	0,	0,	0,	0	} },	
/*143*/		{ 0, { 0,	0,	0,	0,	0,	0,	0,	0	} },	
/*144*/		{ 8, { 127,	0,	0,	0,	0,	0,	0,	0	} },	
/*145*/		{ 3, { 224,	0,	0,	0,	0,	0,	0,	0	} },	
/*146*/		{ 8, { 251,	0,	0,	0,	0,	0,	0,	0	} },	
/*147*/		{ 3, { 224,	0,	0,	0,	0,	0,	0,	0	} },	
/*148*/		{ 0, { 0,	0,	0,	0,	0,	0,	0,	0	} },	
/*149*/		{ 5, { 56,	0,	0,	0,	0,	0,	0,	0	} },	
/*150*/		{ 8, { 224,	32,	32,	32,	32,	32,	63,	0	} },	
/*151*/		{ 1, { 128,	128,	128,	128,	128,	128,	128,	0	} },	
/*152*/		{ 8, { 225,	162,	164,	168,	176,	160,	255,	128	} },	
/*153*/		{ 8, { 129,	129,	129,	129,	129,	129,	129,	1	} },	
/*154*/		{ 3, { 32,	64,	128,	0,	0,	0,	0,	0	} },	
/*155*/		{ 3, { 128,	64,	32,	0,	0,	0,	0,	0	} },	
/*156*/		{ 0, { 0,	0,	0,	0,	0,	0,	0,	0	} },	
/*157*/		{ 0, { 0,	0,	0,	0,	0,	0,	0,	0	} },	
/*158*/		{ 0, { 0,	0,	0,	0,	0,	0,	0,	0	} },	
/*159*/		{ 0, { 0,	0,	0,	0,	0,	0,	0,	0	} },	
/*160*/		{ 0, { 0,	0,	0,	0,	0,	0,	0,	0	} },	
/*161*/		{ 0, { 0,	0,	0,	0,	0,	0,	0,	0	} },	
/*162*/		{ 0, { 0,	0,	0,	0,	0,	0,	0,	0	} },	
/*163*/		{ 0, { 0,	0,	0,	0,	0,	0,	0,	0	} },	
/*164*/		{ 0, { 0,	0,	0,	0,	0,	0,	0,	0	} },	
/*165*/		{ 0, { 0,	0,	0,	0,	0,	0,	0,	0	} },	
/*166*/		{ 0, { 0,	0,	0,	0,	0,	0,	0,	0	} },	
/*167*/		{ 0, { 0,	0,	0,	0,	0,	0,	0,	0	} },	
/*168*/		{ 0, { 0,	0,	0,	0,	0,	0,	0,	0	} },	
/*169*/		{ 0, { 0,	0,	0,	0,	0,	0,	0,	0	} },	
/*170*/		{ 0, { 0,	0,	0,	0,	0,	0,	0,	0	} },	
/*171*/		{ 0, { 0,	0,	0,	0,	0,	0,	0,	0	} },	
/*172*/		{ 0, { 0,	0,	0,	0,	0,	0,	0,	0	} },	
/*173*/		{ 0, { 0,	0,	0,	0,	0,	0,	0,	0	} },	
/*174*/		{ 0, { 0,	0,	0,	0,	0,	0,	0,	0	} },	
/*175*/		{ 0, { 0,	0,	0,	0,	0,	0,	0,	0	} },	
/*176*/		{ 0, { 0,	0,	0,	0,	0,	0,	0,	0	} },	
/*177*/		{ 0, { 0,	0,	0,	0,	0,	0,	0,	0	} },	
/*178*/		{ 0, { 0,	0,	0,	0,	0,	0,	0,	0	} },	
/*179*/		{ 0, { 0,	0,	0,	0,	0,	0,	0,	0	} },	
/*180*/		{ 0, { 0,	0,	0,	0,	0,	0,	0,	0	} },	
/*181*/		{ 0, { 0,	0,	0,	0,	0,	0,	0,	0	} },	
/*182*/		{ 0, { 0,	0,	0,	0,	0,	0,	0,	0	} },	
/*183*/		{ 0, { 0,	0,	0,	0,	0,	0,	0,	0	} },	
/*184*/		{ 0, { 0,	0,	0,	0,	0,	0,	0,	0	} },	
/*185*/		{ 0, { 0,	0,	0,	0,	0,	0,	0,	0	} },	
/*186*/		{ 0, { 0,	0,	0,	0,	0,	0,	0,	0	} },	
/*187*/		{ 0, { 0,	0,	0,	0,	0,	0,	0,	0	} },	
/*188*/		{ 0, { 0,	0,	0,	0,	0,	0,	0,	0	} },	
/*189*/		{ 0, { 0,	0,	0,	0,	0,	0,	0,	0	} },	
/*190*/		{ 0, { 0,	0,	0,	0,	0,	0,	0,	0	} },	
/*191*/		{ 0, { 0,	0,	0,	0,	0,	0,	0,	0	} },	
/*192*/		{ 0, { 0,	0,	0,	0,	0,	0,	0,	0	} },	
/*193*/		{ 0, { 0,	0,	0,	0,	0,	0,	0,	0	} },	
/*194*/		{ 0, { 0,	0,	0,	0,	0,	0,	0,	0	} },	
/*195*/		{ 0, { 0,	0,	0,	0,	0,	0,	0,	0	} },	
/*196*/		{ 0, { 0,	0,	0,	0,	0,	0,	0,	0	} },	
/*197*/		{ 0, { 0,	0,	0,	0,	0,	0,	0,	0	} },	
/*198*/		{ 0, { 0,	0,	0,	0,	0,	0,	0,	0	} },	
/*199*/		{ 0, { 0,	0,	0,	0,	0,	0,	0,	0	} },	
/*200*/		{ 0, { 0,	0,	0,	0,	0,	0,	0,	0	} },	
/*201*/		{ 0, { 0,	0,	0,	0,	0,	0,	0,	0	} },	
/*202*/		{ 0, { 0,	0,	0,	0,	0,	0,	0,	0	} },	
/*203*/		{ 0, { 0,	0,	0,	0,	0,	0,	0,	0	} },	
/*204*/		{ 0, { 0,	0,	0,	0,	0,	0,	0,	0	} },	
/*205*/		{ 0, { 0,	0,	0,	0,	0,	0,	0,	0	} },	
/*206*/		{ 0, { 0,	0,	0,	0,	0,	0,	0,	0	} },	
/*207*/		{ 0, { 0,	0,	0,	0,	0,	0,	0,	0	} },	
/*208*/		{ 0, { 0,	0,	0,	0,	0,	0,	0,	0	} },	
/*209*/		{ 0, { 0,	0,	0,	0,	0,	0,	0,	0	} },	
/*210*/		{ 0, { 0,	0,	0,	0,	0,	0,	0,	0	} },	
/*211*/		{ 0, { 0,	0,	0,	0,	0,	0,	0,	0	} },	
/*212*/		{ 0, { 0,	0,	0,	0,	0,	0,	0,	0	} },	
/*213*/		{ 0, { 0,	0,	0,	0,	0,	0,	0,	0	} },	
/*214*/		{ 0, { 0,	0,	0,	0,	0,	0,	0,	0	} },	
/*215*/		{ 0, { 0,	0,	0,	0,	0,	0,	0,	0	} },	
/*216*/		{ 0, { 0,	0,	0,	0,	0,	0,	0,	0	} },	
/*217*/		{ 0, { 0,	0,	0,	0,	0,	0,	0,	0	} },	
/*218*/		{ 0, { 0,	0,	0,	0,	0,	0,	0,	0	} },	
/*219*/		{ 0, { 0,	0,	0,	0,	0,	0,	0,	0	} },	
/*220*/		{ 0, { 0,	0,	0,	0,	0,	0,	0,	0	} },	
/*221*/		{ 0, { 0,	0,	0,	0,	0,	0,	0,	0	} },	
/*222*/		{ 0, { 0,	0,	0,	0,	0,	0,	0,	0	} },	
/*223*/		{ 0, { 0,	0,	0,	0,	0,	0,	0,	0	} },	
/*224*/		{ 0, { 0,	0,	0,	0,	0,	0,	0,	0	} },	
/*225*/		{ 0, { 0,	0,	0,	0,	0,	0,	0,	0	} },	
/*226*/		{ 0, { 0,	0,	0,	0,	0,	0,	0,	0	} },	
/*227*/		{ 0, { 0,	0,	0,	0,	0,	0,	0,	0	} },	
/*228*/		{ 0, { 0,	0,	0,	0,	0,	0,	0,	0	} },	
/*229*/		{ 0, { 0,	0,	0,	0,	0,	0,	0,	0	} },	
/*230*/		{ 0, { 0,	0,	0,	0,	0,	0,	0,	0	} },	
/*231*/		{ 0, { 0,	0,	0,	0,	0,	0,	0,	0	} },	
/*232*/		{ 0, { 0,	0,	0,	0,	0,	0,	0,	0	} },	
/*233*/		{ 0, { 0,	0,	0,	0,	0,	0,	0,	0	} },	
/*234*/		{ 0, { 0,	0,	0,	0,	0,	0,	0,	0	} },	
/*235*/		{ 0, { 0,	0,	0,	0,	0,	0,	0,	0	} },	
/*236*/		{ 0, { 0,	0,	0,	0,	0,	0,	0,	0	} },	
/*237*/		{ 0, { 0,	0,	0,	0,	0,	0,	0,	0	} },	
/*238*/		{ 0, { 0,	0,	0,	0,	0,	0,	0,	0	} },	
/*239*/		{ 0, { 0,	0,	0,	0,	0,	0,	0,	0	} },	
/*240*/		{ 0, { 0,	0,	0,	0,	0,	0,	0,	0	} },	
/*241*/		{ 0, { 0,	0,	0,	0,	0,	0,	0,	0	} },	
/*242*/		{ 0, { 0,	0,	0,	0,	0,	0,	0,	0	} },	
/*243*/		{ 0, { 0,	0,	0,	0,	0,	0,	0,	0	} },	
/*244*/		{ 0, { 0,	0,	0,	0,	0,	0,	0,	0	} },	
/*245*/		{ 0, { 0,	0,	0,	0,	0,	0,	0,	0	} },	
/*246*/		{ 0, { 0,	0,	0,	0,	0,	0,	0,	0	} },	
/*247*/		{ 0, { 0,	0,	0,	0,	0,	0,	0,	0	} },	
/*248*/		{ 0, { 0,	0,	0,	0,	0,	0,	0,	0	} },	
/*249*/		{ 0, { 0,	0,	0,	0,	0,	0,	0,	0	} },	
/*250*/		{ 0, { 0,	0,	0,	0,	0,	0,	0,	0	} },	
/*251*/		{ 0, { 0,	0,	0,	0,	0,	0,	0,	0	} },	
/*252*/		{ 0, { 0,	0,	0,	0,	0,	0,	0,	0	} },	
/*253*/		{ 0, { 0,	0,	0,	0,	0,	0,	0,	0	} },	
/*254*/		{ 0, { 0,	0,	0,	0,	0,	0,	0,	0	} },	
/*255*/		{ 0, { 0,	0,	0,	0,	0,	0,	0,	0	} }	
} };
