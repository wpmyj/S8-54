const BYTE fontUGOdisplay[3080] = {
/* Orient = 0x00, FontID = 0x00 */ 0x00, 0x00,
/* First character ID */           0x00, 0x00,
/* Last  character ID */           0xff, 0xff,
/* Height */                       0x08, 0x00,

/* Table of characters */

/* 0 */	        0, 8, 4, 0,
/* 1 */	        0, 16, 4, 0,
/* 2 */	        0, 24, 4, 0,
/* 3 */	        0, 32, 4, 0,
/* 4 */	        0, 40, 4, 0,
/* 5 */	        0, 48, 4, 0,
/* 6 */	        0, 56, 4, 0,
/* 7 */	        0, 64, 4, 0,
/* 8 */	        0, 72, 4, 0,
/* 9 */	        0, 80, 4, 0,
/* 10 */	        0, 88, 4, 0,
/* 11 */	        0, 96, 4, 0,
/* 12 */	        0, 104, 4, 0,
/* 13 */	        0, 112, 4, 0,
/* 14 */	        0, 120, 4, 0,
/* 15 */	        0, 128, 4, 0,
/* 16 */	        0, 136, 4, 0,
/* 17 */	        1, 144, 4, 0,
/* 18 */	        2, 152, 4, 0,
/* 19 */	        3, 160, 4, 0,
/* 20 */	        4, 168, 4, 0,
/* 21 */	        5, 176, 4, 0,
/* 22 */	        6, 184, 4, 0,
/* 23 */	        7, 192, 4, 0,
/* 24 */	        8, 200, 4, 0,
/* 25 */	        9, 208, 4, 0,
/* 26 */	        10, 216, 4, 0,
/* 27 */	        11, 224, 4, 0,
/* 28 */	        12, 232, 4, 0,
/* 29 */	        13, 240, 4, 0,
/* 30 */	        14, 248, 4, 0,
/* 31 */	        15, 0, 5, 0,
/* 32 */	        8, 8, 5, 0,
/* 33 */	        8, 16, 5, 0,
/* 34 */	        7, 24, 5, 0,
/* 35 */	        8, 32, 5, 0,
/* 36 */	        8, 40, 5, 0,
/* 37 */	        8, 48, 5, 0,
/* 38 */	        8, 56, 5, 0,
/* 39 */	        7, 64, 5, 0,
/* 40 */	        8, 72, 5, 0,
/* 41 */	        7, 80, 5, 0,
/* 42 */	        7, 88, 5, 0,
/* 43 */	        8, 96, 5, 0,
/* 44 */	        7, 104, 5, 0,
/* 45 */	        8, 112, 5, 0,
/* 46 */	        7, 120, 5, 0,
/* 47 */	        0, 128, 5, 0,
/* 48 */	        5, 136, 5, 0,
/* 49 */	        5, 144, 5, 0,
/* 50 */	        8, 152, 5, 0,
/* 51 */	        6, 160, 5, 0,
/* 52 */	        8, 168, 5, 0,
/* 53 */	        7, 176, 5, 0,
/* 54 */	        7, 184, 5, 0,
/* 55 */	        8, 192, 5, 0,
/* 56 */	        7, 200, 5, 0,
/* 57 */	        8, 208, 5, 0,
/* 58 */	        8, 216, 5, 0,
/* 59 */	        7, 224, 5, 0,
/* 60 */	        8, 232, 5, 0,
/* 61 */	        7, 240, 5, 0,
/* 62 */	        8, 248, 5, 0,
/* 63 */	        0, 0, 6, 0,
/* 64 */	        8, 8, 6, 0,
/* 65 */	        8, 16, 6, 0,
/* 66 */	        7, 24, 6, 0,
/* 67 */	        8, 32, 6, 0,
/* 68 */	        8, 40, 6, 0,
/* 69 */	        8, 48, 6, 0,
/* 70 */	        8, 56, 6, 0,
/* 71 */	        8, 64, 6, 0,
/* 72 */	        8, 72, 6, 0,
/* 73 */	        7, 80, 6, 0,
/* 74 */	        7, 88, 6, 0,
/* 75 */	        8, 96, 6, 0,
/* 76 */	        7, 104, 6, 0,
/* 77 */	        8, 112, 6, 0,
/* 78 */	        7, 120, 6, 0,
/* 79 */	        0, 128, 6, 0,
/* 80 */	        5, 136, 6, 0,
/* 81 */	        5, 144, 6, 0,
/* 82 */	        8, 152, 6, 0,
/* 83 */	        6, 160, 6, 0,
/* 84 */	        8, 168, 6, 0,
/* 85 */	        5, 176, 6, 0,
/* 86 */	        5, 184, 6, 0,
/* 87 */	        8, 192, 6, 0,
/* 88 */	        4, 200, 6, 0,
/* 89 */	        8, 208, 6, 0,
/* 90 */	        8, 216, 6, 0,
/* 91 */	        7, 224, 6, 0,
/* 92 */	        8, 232, 6, 0,
/* 93 */	        7, 240, 6, 0,
/* 94 */	        8, 248, 6, 0,
/* 95 */	        0, 0, 7, 0,
/* 96 */	        8, 8, 7, 0,
/* 97 */	        8, 16, 7, 0,
/* 98 */	        8, 24, 7, 0,
/* 99 */	        8, 32, 7, 0,
/* 100 */	        8, 40, 7, 0,
/* 101 */	        8, 48, 7, 0,
/* 102 */	        8, 56, 7, 0,
/* 103 */	        8, 64, 7, 0,
/* 104 */	        8, 72, 7, 0,
/* 105 */	        8, 80, 7, 0,
/* 106 */	        8, 88, 7, 0,
/* 107 */	        8, 96, 7, 0,
/* 108 */	        8, 104, 7, 0,
/* 109 */	        8, 112, 7, 0,
/* 110 */	        8, 120, 7, 0,
/* 111 */	        0, 128, 7, 0,
/* 112 */	        5, 136, 7, 0,
/* 113 */	        8, 144, 7, 0,
/* 114 */	        4, 152, 7, 0,
/* 115 */	        8, 160, 7, 0,
/* 116 */	        2, 168, 7, 0,
/* 117 */	        5, 176, 7, 0,
/* 118 */	        8, 184, 7, 0,
/* 119 */	        4, 192, 7, 0,
/* 120 */	        8, 200, 7, 0,
/* 121 */	        2, 208, 7, 0,
/* 122 */	        8, 216, 7, 0,
/* 123 */	        8, 224, 7, 0,
/* 124 */	        8, 232, 7, 0,
/* 125 */	        0, 240, 7, 0,
/* 126 */	        0, 248, 7, 0,
/* 127 */	        0, 0, 8, 0,
/* 128 */	        8, 8, 8, 0,
/* 129 */	        8, 16, 8, 0,
/* 130 */	        7, 24, 8, 0,
/* 131 */	        0, 32, 8, 0,
/* 132 */	        0, 40, 8, 0,
/* 133 */	        8, 48, 8, 0,
/* 134 */	        8, 56, 8, 0,
/* 135 */	        8, 64, 8, 0,
/* 136 */	        8, 72, 8, 0,
/* 137 */	        0, 80, 8, 0,
/* 138 */	        8, 88, 8, 0,
/* 139 */	        8, 96, 8, 0,
/* 140 */	        8, 104, 8, 0,
/* 141 */	        8, 112, 8, 0,
/* 142 */	        8, 120, 8, 0,
/* 143 */	        0, 128, 8, 0,
/* 144 */	        8, 136, 8, 0,
/* 145 */	        8, 144, 8, 0,
/* 146 */	        8, 152, 8, 0,
/* 147 */	        8, 160, 8, 0,
/* 148 */	        8, 168, 8, 0,
/* 149 */	        8, 176, 8, 0,
/* 150 */	        8, 184, 8, 0,
/* 151 */	        8, 192, 8, 0,
/* 152 */	        8, 200, 8, 0,
/* 153 */	        8, 208, 8, 0,
/* 154 */	        8, 216, 8, 0,
/* 155 */	        8, 224, 8, 0,
/* 156 */	        8, 232, 8, 0,
/* 157 */	        8, 240, 8, 0,
/* 158 */	        0, 248, 8, 0,
/* 159 */	        0, 0, 9, 0,
/* 160 */	        0, 8, 9, 0,
/* 161 */	        0, 16, 9, 0,
/* 162 */	        8, 24, 9, 0,
/* 163 */	        8, 32, 9, 0,
/* 164 */	        8, 40, 9, 0,
/* 165 */	        8, 48, 9, 0,
/* 166 */	        8, 56, 9, 0,
/* 167 */	        5, 64, 9, 0,
/* 168 */	        0, 72, 9, 0,
/* 169 */	        0, 80, 9, 0,
/* 170 */	        8, 88, 9, 0,
/* 171 */	        8, 96, 9, 0,
/* 172 */	        8, 104, 9, 0,
/* 173 */	        1, 112, 9, 0,
/* 174 */	        0, 120, 9, 0,
/* 175 */	        0, 128, 9, 0,
/* 176 */	        8, 136, 9, 0,
/* 177 */	        8, 144, 9, 0,
/* 178 */	        8, 152, 9, 0,
/* 179 */	        4, 160, 9, 0,
/* 180 */	        0, 168, 9, 0,
/* 181 */	        0, 176, 9, 0,
/* 182 */	        8, 184, 9, 0,
/* 183 */	        8, 192, 9, 0,
/* 184 */	        8, 200, 9, 0,
/* 185 */	        8, 208, 9, 0,
/* 186 */	        8, 216, 9, 0,
/* 187 */	        8, 224, 9, 0,
/* 188 */	        8, 232, 9, 0,
/* 189 */	        8, 240, 9, 0,
/* 190 */	        8, 248, 9, 0,
/* 191 */	        0, 0, 10, 0,
/* 192 */	        8, 8, 10, 0,
/* 193 */	        3, 16, 10, 0,
/* 194 */	        8, 24, 10, 0,
/* 195 */	        8, 32, 10, 0,
/* 196 */	        8, 40, 10, 0,
/* 197 */	        8, 48, 10, 0,
/* 198 */	        8, 56, 10, 0,
/* 199 */	        8, 64, 10, 0,
/* 200 */	        8, 72, 10, 0,
/* 201 */	        8, 80, 10, 0,
/* 202 */	        8, 88, 10, 0,
/* 203 */	        3, 96, 10, 0,
/* 204 */	        8, 104, 10, 0,
/* 205 */	        8, 112, 10, 0,
/* 206 */	        0, 120, 10, 0,
/* 207 */	        0, 128, 10, 0,
/* 208 */	        0, 136, 10, 0,
/* 209 */	        8, 144, 10, 0,
/* 210 */	        7, 152, 10, 0,
/* 211 */	        0, 160, 10, 0,
/* 212 */	        0, 168, 10, 0,
/* 213 */	        8, 176, 10, 0,
/* 214 */	        8, 184, 10, 0,
/* 215 */	        8, 192, 10, 0,
/* 216 */	        8, 200, 10, 0,
/* 217 */	        0, 208, 10, 0,
/* 218 */	        0, 216, 10, 0,
/* 219 */	        8, 224, 10, 0,
/* 220 */	        7, 232, 10, 0,
/* 221 */	        8, 240, 10, 0,
/* 222 */	        8, 248, 10, 0,
/* 223 */	        0, 0, 11, 0,
/* 224 */	        8, 8, 11, 0,
/* 225 */	        8, 16, 11, 0,
/* 226 */	        8, 24, 11, 0,
/* 227 */	        8, 32, 11, 0,
/* 228 */	        8, 40, 11, 0,
/* 229 */	        8, 48, 11, 0,
/* 230 */	        8, 56, 11, 0,
/* 231 */	        8, 64, 11, 0,
/* 232 */	        8, 72, 11, 0,
/* 233 */	        2, 80, 11, 0,
/* 234 */	        0, 88, 11, 0,
/* 235 */	        0, 96, 11, 0,
/* 236 */	        0, 104, 11, 0,
/* 237 */	        0, 112, 11, 0,
/* 238 */	        0, 120, 11, 0,
/* 239 */	        0, 128, 11, 0,
/* 240 */	        8, 136, 11, 0,
/* 241 */	        8, 144, 11, 0,
/* 242 */	        8, 152, 11, 0,
/* 243 */	        8, 160, 11, 0,
/* 244 */	        2, 168, 11, 0,
/* 245 */	        8, 176, 11, 0,
/* 246 */	        8, 184, 11, 0,
/* 247 */	        8, 192, 11, 0,
/* 248 */	        8, 200, 11, 0,
/* 249 */	        8, 208, 11, 0,
/* 250 */	        0, 216, 11, 0,
/* 251 */	        0, 224, 11, 0,
/* 252 */	        0, 232, 11, 0,
/* 253 */	        0, 240, 11, 0,
/* 254 */	        0, 248, 11, 0,
/* 255 */	        0, 0, 12, 0,

/* Map of characters */

/* 0 */	       0,0,0,0,0,0,0,0,
/* 1 */	       0,0,0,0,0,0,0,0,
/* 2 */	       0,0,0,0,0,0,0,0,
/* 3 */	       0,0,0,0,0,0,0,0,
/* 4 */	       0,0,0,0,0,0,0,0,
/* 5 */	       0,0,0,0,0,0,0,0,
/* 6 */	       0,0,0,0,0,0,0,0,
/* 7 */	       0,0,0,0,0,0,0,0,
/* 8 */	       0,0,0,0,0,0,0,0,
/* 9 */	       0,0,0,0,0,0,0,0,
/* 10 */	       0,0,0,0,0,0,0,0,
/* 11 */	       0,0,0,0,0,0,0,0,
/* 12 */	       0,0,0,0,0,0,0,0,
/* 13 */	       0,0,0,0,0,0,0,0,
/* 14 */	       0,0,0,0,0,0,0,0,
/* 15 */	       0,0,0,0,0,0,0,0,
/* 16 */	       0,0,0,0,0,0,0,0,
/* 17 */	       0,0,0,0,0,0,0,0,
/* 18 */	       0,0,0,0,0,0,0,0,
/* 19 */	       0,0,0,0,0,0,0,0,
/* 20 */	       0,0,0,0,0,0,0,0,
/* 21 */	       0,0,0,0,0,0,0,0,
/* 22 */	       0,0,0,0,0,0,0,0,
/* 23 */	       0,0,0,0,0,0,0,0,
/* 24 */	       0,0,0,0,0,0,0,0,
/* 25 */	       0,0,0,0,0,0,0,0,
/* 26 */	       0,0,0,0,0,0,0,0,
/* 27 */	       0,0,0,0,0,0,0,0,
/* 28 */	       0,0,0,0,0,0,0,0,
/* 29 */	       0,0,0,0,0,0,0,0,
/* 30 */	       0,0,0,0,0,0,0,0,
/* 31 */	       0,0,0,0,0,0,0,0,
/* 32 */	       68,14,31,4,4,4,4,196,
/* 33 */	       85,96,208,144,16,16,16,19,
/* 34 */	       85,0,31,49,32,32,32,96,
/* 35 */	       85,192,160,32,32,32,32,32,
/* 36 */	       85,0,63,99,64,64,64,192,
/* 37 */	       0,0,0,0,0,0,0,192,
/* 38 */	       0,96,208,144,16,16,16,19,
/* 39 */	       0,0,31,49,32,32,32,96,
/* 40 */	       0,0,128,128,128,128,128,196,
/* 41 */	       0,3,60,96,64,64,64,64,
/* 42 */	       68,14,31,4,4,4,4,4,
/* 43 */	       85,48,232,8,8,8,8,8,
/* 44 */	       85,0,3,4,4,4,4,12,
/* 45 */	       85,56,236,4,4,4,4,4,
/* 46 */	       85,0,1,6,4,4,4,4,
/* 47 */	       0,0,0,0,0,0,0,0,
/* 48 */	       4,4,4,4,4,4,4,31,
/* 49 */	       22,12,0,0,0,0,0,0,
/* 50 */	       64,128,0,0,0,0,0,0,
/* 51 */	       38,47,24,0,0,0,0,0,
/* 52 */	       128,0,0,0,0,0,0,0,
/* 53 */	       0,0,68,14,31,4,4,31,
/* 54 */	       22,12,85,0,0,0,0,0,
/* 55 */	       192,0,85,0,0,0,0,0,
/* 56 */	       79,56,85,0,0,0,0,0,
/* 57 */	       64,128,85,0,0,0,0,0,
/* 58 */	       4,223,14,68,0,0,0,0,
/* 59 */	       8,13,3,85,0,0,0,0,
/* 60 */	       8,56,224,85,0,0,0,0,
/* 61 */	       4,6,3,85,0,0,0,0,
/* 62 */	       4,228,56,85,0,0,0,0,
/* 63 */	       0,0,0,0,0,0,0,0,
/* 64 */	       0,0,68,14,31,4,4,196,
/* 65 */	       64,96,213,144,16,16,16,19,
/* 66 */	       0,0,95,49,32,32,32,96,
/* 67 */	       128,224,117,32,32,32,32,32,
/* 68 */	       0,0,63,98,64,64,64,192,
/* 69 */	       0,0,0,0,0,0,0,196,
/* 70 */	       64,96,208,144,16,16,16,87,
/* 71 */	       0,0,15,25,16,16,16,245,
/* 72 */	       32,96,208,144,16,16,24,95,
/* 73 */	       0,16,31,21,16,16,16,117,
/* 74 */	       0,0,68,14,31,4,4,4,
/* 75 */	       64,96,181,16,16,16,16,16,
/* 76 */	       0,0,95,32,32,32,32,32,
/* 77 */	       32,224,213,16,16,16,16,16,
/* 78 */	       0,0,95,32,32,32,32,32,
/* 79 */	       0,0,0,0,0,0,0,0,
/* 80 */	       4,4,4,4,4,4,4,31,
/* 81 */	       22,12,0,0,0,0,0,0,
/* 82 */	       64,128,0,0,0,0,0,0,
/* 83 */	       38,47,24,0,0,0,0,0,
/* 84 */	       128,0,0,0,0,0,0,0,
/* 85 */	       14,31,4,4,4,4,4,31,
/* 86 */	       22,12,0,0,0,0,0,0,
/* 87 */	       192,0,0,0,0,0,0,0,
/* 88 */	       9,0,0,0,0,0,0,0,
/* 89 */	       192,0,0,0,0,0,0,0,
/* 90 */	       31,14,196,0,0,0,0,0,
/* 91 */	       16,16,95,12,0,0,0,0,
/* 92 */	       32,32,213,0,0,0,0,0,
/* 93 */	       16,16,95,14,8,0,0,0,
/* 94 */	       32,32,213,0,0,0,0,0,
/* 95 */	       0,0,0,0,0,0,0,0,
/* 96 */	       0,0,128,128,64,224,68,14,
/* 97 */	       6,9,16,16,32,170,32,64,
/* 98 */	       128,64,32,32,16,186,16,8,
/* 99 */	       1,2,4,4,8,170,8,16,
/* 100 */	       96,144,8,8,4,174,4,2,
/* 101 */	       0,0,164,142,95,68,68,4,
/* 102 */	       6,9,186,16,32,32,32,64,
/* 103 */	       128,64,170,32,16,16,16,8,
/* 104 */	       1,2,174,4,8,8,8,16,
/* 105 */	       96,144,170,8,4,4,4,2,
/* 106 */	       164,14,31,4,31,14,164,0,
/* 107 */	       170,0,0,0,0,0,170,0,
/* 108 */	       170,5,5,37,85,85,85,85,
/* 109 */	       170,0,0,0,0,0,255,1,
/* 110 */	       170,0,0,0,0,0,255,0,
/* 111 */	       0,0,0,0,0,0,0,0,
/* 112 */	       31,4,4,4,4,4,4,31,
/* 113 */	       64,128,0,0,0,0,0,0,
/* 114 */	       8,4,3,0,0,0,0,0,
/* 115 */	       16,32,192,0,0,0,0,0,
/* 116 */	       2,1,0,0,0,0,0,0,
/* 117 */	       4,4,4,4,4,4,4,31,
/* 118 */	       64,128,0,0,0,0,0,0,
/* 119 */	       8,4,3,0,0,0,0,0,
/* 120 */	       16,32,192,0,0,0,0,0,
/* 121 */	       2,1,0,0,0,0,0,0,
/* 122 */	       0,0,0,0,224,0,0,0,
/* 123 */	       0,0,0,0,127,128,0,0,
/* 124 */	       149,21,9,1,1,0,0,0,
/* 125 */	       0,0,0,0,0,0,0,0,
/* 126 */	       0,0,0,0,0,0,0,0,
/* 127 */	       0,0,0,0,0,0,0,0,
/* 128 */	       0,0,255,0,0,0,0,0,
/* 129 */	       0,0,255,128,128,128,128,128,
/* 130 */	       0,0,0,0,0,0,4,74,
/* 131 */	       0,0,0,0,0,0,0,0,
/* 132 */	       0,0,0,0,0,0,0,0,
/* 133 */	       128,128,128,128,224,128,128,128,
/* 134 */	       255,128,128,128,131,128,128,128,
/* 135 */	       128,128,128,128,224,128,128,128,
/* 136 */	       255,128,128,128,131,128,128,128,
/* 137 */	       0,0,0,0,0,0,0,0,
/* 138 */	       254,128,128,128,224,128,134,132,
/* 139 */	       128,128,128,128,131,128,128,128,
/* 140 */	       255,128,128,128,224,128,128,128,
/* 141 */	       128,128,128,128,131,128,128,128,
/* 142 */	       255,0,0,0,0,0,0,0,
/* 143 */	       0,0,0,0,0,0,0,0,
/* 144 */	       168,28,62,0,62,28,72,0,
/* 145 */	       170,128,128,128,128,128,85,0,
/* 146 */	       170,42,42,42,18,2,1,0,
/* 147 */	       255,0,0,0,0,0,0,0,
/* 148 */	       255,0,0,0,0,0,0,0,
/* 149 */	       254,0,0,0,128,0,0,0,
/* 150 */	       128,0,2,3,255,3,2,0,
/* 151 */	       255,0,32,96,255,96,32,0,
/* 152 */	       128,0,0,0,0,0,0,0,
/* 153 */	       255,0,0,0,0,0,0,0,
/* 154 */	       132,4,78,32,144,8,4,0,
/* 155 */	       255,0,2,3,255,3,2,0,
/* 156 */	       128,0,32,96,255,96,32,0,
/* 157 */	       255,0,0,0,0,0,0,0,
/* 158 */	       0,0,0,0,0,0,0,0,
/* 159 */	       0,0,0,0,0,0,0,0,
/* 160 */	       0,0,0,0,0,0,0,0,
/* 161 */	       0,0,0,0,0,0,0,0,
/* 162 */	       0,0,128,0,128,64,32,16,
/* 163 */	       248,4,15,1,0,0,0,0,
/* 164 */	       255,0,0,0,0,0,0,0,
/* 165 */	       255,0,0,0,0,0,0,0,
/* 166 */	       63,64,224,0,0,0,0,0,
/* 167 */	       0,0,3,1,2,4,8,16,
/* 168 */	       0,0,0,0,0,0,0,0,
/* 169 */	       0,0,0,0,0,0,0,0,
/* 170 */	       0,0,0,0,192,0,0,0,
/* 171 */	       255,1,1,1,7,1,1,1,
/* 172 */	       127,64,64,64,240,64,64,64,
/* 173 */	       0,0,0,0,1,0,0,0,
/* 174 */	       0,0,0,0,0,0,0,0,
/* 175 */	       0,0,0,0,0,0,0,0,
/* 176 */	       0,0,0,0,255,0,0,0,
/* 177 */	       0,0,128,0,255,0,0,0,
/* 178 */	       136,196,239,193,128,0,0,0,
/* 179 */	       2,6,15,6,2,0,0,0,
/* 180 */	       0,0,0,0,0,0,0,0,
/* 181 */	       0,0,0,0,0,0,0,0,
/* 182 */	       128,192,224,192,128,0,0,0,
/* 183 */	       34,70,239,6,2,0,0,0,
/* 184 */	       0,0,3,1,254,0,0,0,
/* 185 */	       0,0,0,0,255,0,0,0,
/* 186 */	       255,0,0,0,0,0,0,0,
/* 187 */	       1,0,4,6,255,6,4,0,
/* 188 */	       192,0,16,48,127,48,16,0,
/* 189 */	       255,0,0,0,0,0,0,0,
/* 190 */	       255,0,0,0,0,0,0,0,
/* 191 */	       0,0,0,0,0,0,0,0,
/* 192 */	       255,0,0,0,192,0,0,0,
/* 193 */	       1,1,1,1,7,1,1,1,
/* 194 */	       192,64,64,64,240,64,64,64,
/* 195 */	       255,0,0,0,1,0,0,0,
/* 196 */	       255,0,0,0,0,0,0,0,
/* 197 */	       0,0,0,0,192,0,0,0,
/* 198 */	       255,1,1,1,7,1,1,1,
/* 199 */	       127,64,64,64,240,64,64,64,
/* 200 */	       128,128,128,128,129,128,128,128,
/* 201 */	       255,0,0,0,0,0,0,0,
/* 202 */	       255,0,0,0,192,0,0,0,
/* 203 */	       1,1,1,1,7,1,1,1,
/* 204 */	       192,64,64,64,240,64,64,64,
/* 205 */	       255,128,128,128,129,128,128,128,
/* 206 */	       0,0,0,0,0,0,0,0,
/* 207 */	       0,0,0,0,0,0,0,0,
/* 208 */	       0,0,0,0,0,0,0,0,
/* 209 */	       255,0,4,6,255,6,4,0,
/* 210 */	       127,0,16,48,127,48,16,0,
/* 211 */	       0,0,0,0,0,0,0,0,
/* 212 */	       0,0,0,0,0,0,0,0,
/* 213 */	       255,0,0,0,0,0,0,0,
/* 214 */	       1,0,4,6,255,6,4,0,
/* 215 */	       192,0,16,48,127,48,16,0,
/* 216 */	       255,0,0,0,0,0,0,0,
/* 217 */	       0,0,0,0,0,0,0,0,
/* 218 */	       0,0,0,0,0,0,0,0,
/* 219 */	       255,0,4,6,255,6,4,0,
/* 220 */	       127,0,16,48,127,48,16,0,
/* 221 */	       128,0,0,0,0,0,0,0,
/* 222 */	       255,0,0,0,0,0,0,0,
/* 223 */	       0,0,0,0,0,0,0,0,
/* 224 */	       0,0,0,0,192,128,128,128,
/* 225 */	       252,4,4,4,68,100,244,100,
/* 226 */	       255,0,0,0,0,0,255,0,
/* 227 */	       255,0,224,32,162,38,175,166,
/* 228 */	       255,0,255,0,3,2,3,0,
/* 229 */	       255,0,255,0,192,128,128,128,
/* 230 */	       255,0,7,4,68,100,244,100,
/* 231 */	       255,0,0,0,0,0,255,0,
/* 232 */	       63,32,32,32,162,38,175,166,
/* 233 */	       0,0,0,0,3,2,3,0,
/* 234 */	       0,0,0,0,0,0,0,0,
/* 235 */	       0,0,0,0,0,0,0,0,
/* 236 */	       0,0,0,0,0,0,0,0,
/* 237 */	       0,0,0,0,0,0,0,0,
/* 238 */	       0,0,0,0,0,0,0,0,
/* 239 */	       0,0,0,0,0,0,0,0,
/* 240 */	       192,0,255,0,255,0,0,0,
/* 241 */	       69,4,7,0,255,0,0,0,
/* 242 */	       0,0,0,0,255,0,0,0,
/* 243 */	       162,32,32,32,63,0,0,0,
/* 244 */	       3,0,0,0,0,0,0,0,
/* 245 */	       192,0,0,0,0,0,0,0,
/* 246 */	       69,4,4,4,252,0,0,0,
/* 247 */	       0,0,0,0,255,0,0,0,
/* 248 */	       162,32,224,0,255,0,0,0,
/* 249 */	       3,0,255,0,255,0,0,0,
/* 250 */	       0,0,0,0,0,0,0,0,
/* 251 */	       0,0,0,0,0,0,0,0,
/* 252 */	       0,0,0,0,0,0,0,0,
/* 253 */	       0,0,0,0,0,0,0,0,
/* 254 */	       0,0,0,0,0,0,0,0,
/* 255 */	       0,0,0,0,0,0,0,0
};
